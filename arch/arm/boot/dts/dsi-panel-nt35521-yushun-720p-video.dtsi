/* Copyright (c) 2013, The Linux Foundation. All rights reserved.
 *
 * This program is free software; you can redistribute it and/or modify
 * it under the terms of the GNU General Public License version 2 and
 * only version 2 as published by the Free Software Foundation.
 *
 * This program is distributed in the hope that it will be useful,
 * but WITHOUT ANY WARRANTY; without even the implied warranty of
 * MERCHANTABILITY or FITNESS FOR A PARTICULAR PURPOSE.  See the
 * GNU General Public License for more details.
 */

/*---------------------------------------------------------------------------
 * This file is autogenerated file using gcdb parser. Please do not edit it.
 * Update input XML file to add a new entry or update variable in this file
 * VERSION = "1.0"
 *---------------------------------------------------------------------------*/
&mdss_mdp {
	dsi_nt35521_yushun_720p_video: qcom,mdss_dsi_nt35521_yushun_720p_video {
		qcom,mdss-dsi-panel-name = "nt35521 yushun 720p video mode dsi panel";
		qcom,cont-splash-enabled = <1>;
		qcom,mdss-dsi-panel-controller = <&mdss_dsi0>;
		qcom,mdss-dsi-panel-type = "dsi_video_mode";
		qcom,mdss-dsi-panel-destination = "display_1";
		qcom,mdss-dsi-panel-framerate = <60>;
		qcom,mdss-dsi-panel-width = <720>;
		qcom,mdss-dsi-panel-height = <1280>;
		qcom,mdss-dsi-h-front-porch = <120>;
		qcom,mdss-dsi-h-back-porch = <120>;
		qcom,mdss-dsi-h-pulse-width = <8>;
		qcom,mdss-dsi-h-sync-skew = <0>;
		qcom,mdss-dsi-v-back-porch = <8>;
		qcom,mdss-dsi-v-front-porch = <10>;
		qcom,mdss-dsi-v-pulse-width = <4>;
		qcom,mdss-dsi-h-left-border = <0>;
		qcom,mdss-dsi-h-right-border = <0>;
		qcom,mdss-dsi-v-top-border = <0>;
		qcom,mdss-dsi-v-bottom-border = <0>;
		qcom,mdss-dsi-bpp = <24>;
		qcom,mdss-dsi-color-order = <0>;
		qcom,mdss-dsi-underflow-color = <0xff>;
		qcom,mdss-dsi-border-color = <0>;
		qcom,mdss-dsi-pixel-packing = <0>;
		qcom,mdss-dsi-on-command = [29 01 00 00 00 00 06 F0 55 AA 52 08 00 
29 01 00 00 00 00 03 D9 00 02 
29 01 00 00 00 00 05 FF AA 55 A5 80 
29 01 00 00 00 00 03 6F 11 00 
29 01 00 00 00 00 03 F7 20 00 
29 01 00 00 00 00 02 6F 01 
29 01 00 00 00 00 02 B1 21 
29 01 00 00 00 00 06 BD 01 A0 10 08 01 
29 01 00 00 00 00 05 B8 01 02 0C 02 
29 01 00 00 00 00 03 BB 11 11 
29 01 00 00 00 00 03 BC 00 00 
29 01 00 00 00 00 02 B6 02 
29 01 00 00 00 00 11 CC 80 3E 87 00 00 00 00 00 00 00 00 00 00 00 00 05 // lijiangshuo add for LCD CE 20140505
29 01 00 00 00 00 06 F0 55 AA 52 08 01 
29 01 00 00 00 00 03 B0 09 09 
29 01 00 00 00 00 03 B1 09 09 
29 01 00 00 00 00 03 BC 8C 00 
29 01 00 00 00 00 03 BD 8C 00 
29 01 00 00 00 00 02 CA 00 
29 01 00 00 00 00 02 C0 04 
29 01 00 00 00 00 02 BE 9F 
29 01 00 00 00 00 03 B3 1C 1C 
29 01 00 00 00 00 03 B4 17 17 
29 01 00 00 00 00 03 B9 36 36 
29 01 00 00 00 00 03 BA 25 25 
29 01 00 00 00 00 06 F0 55 AA 52 08 02 
29 01 00 00 00 00 02 EE 00 
29 01 00 00 00 00 11 B0 00 9C 00 A3 00 B1 00 B8 00 C1 00 D4 00 E4 01 00 
29 01 00 00 00 00 11 B1 01 1A 01 48 01 73 01 B4 01 EC 01 ED 02 26 02 64 
29 01 00 00 00 00 11 B2 02 8C 02 BF 02 DE 03 00 03 44 03 88 03 AA 03 CC 
29 01 00 00 00 00 05 B3 03 EE 03 FF 
29 01 00 00 00 00 11 B4 00 9C 00 A3 00 B1 00 B8 00 C1 00 D4 00 E4 01 00 
29 01 00 00 00 00 11 B5 01 1A 01 48 01 73 01 B4 01 EC 01 ED 02 26 02 64 
29 01 00 00 00 00 11 B6 02 8C 02 BF 02 DE 03 00 03 44 03 88 03 AA 03 CC 
29 01 00 00 00 00 05 B7 03 EE 03 FF 
29 01 00 00 00 00 11 B8 00 9C 00 A3 00 B1 00 B8 00 C1 00 D4 00 E4 01 00 
29 01 00 00 00 00 11 B9 01 1A 01 48 01 73 01 B4 01 EC 01 ED 02 26 02 64 
29 01 00 00 00 00 11 BA 02 8C 02 BF 02 DE 03 00 03 44 03 88 03 AA 03 CC 
29 01 00 00 00 00 05 BB 03 EE 03 FF 
29 01 00 00 00 00 11 BC 00 9C 00 A3 00 B1 00 B8 00 C1 00 D4 00 E4 01 00 
29 01 00 00 00 00 11 BD 01 1A 01 48 01 73 01 B4 01 EC 01 ED 02 26 02 64 
29 01 00 00 00 00 11 BE 02 8C 02 BF 02 DE 03 00 03 44 03 88 03 AA 03 CC 
29 01 00 00 00 00 05 BF 03 EE 03 FF 
29 01 00 00 00 00 11 C0 00 9C 00 A3 00 B1 00 B8 00 C1 00 D4 00 E4 01 00 
29 01 00 00 00 00 11 C1 01 1A 01 48 01 73 01 B4 01 EC 01 ED 02 26 02 64 
29 01 00 00 00 00 11 C2 02 8C 02 BF 02 DE 03 00 03 44 03 88 03 AA 03 CC 
29 01 00 00 00 00 05 C3 03 EE 03 FF 
29 01 00 00 00 00 11 C4 00 9C 00 A3 00 B1 00 B8 00 C1 00 D4 00 E4 01 00 
29 01 00 00 00 00 11 C5 01 1A 01 48 01 73 01 B4 01 EC 01 ED 02 26 02 64 
29 01 00 00 00 00 11 C6 02 8C 02 BF 02 DE 03 00 03 44 03 88 03 AA 03 CC 
29 01 00 00 00 00 05 C7 03 EE 03 FF 
29 01 00 00 00 00 02 6F 02 
29 01 00 00 00 00 02 F7 47 
29 01 00 00 00 00 02 6F 0A 
29 01 00 00 00 00 02 F7 02 
29 01 00 00 00 00 02 6F 17 
29 01 00 00 00 00 02 F4 60 
29 01 00 00 00 00 06 F0 55 AA 52 08 03 
29 01 00 00 00 00 03 B0 20 00 
29 01 00 00 00 00 03 B1 20 00 
29 01 00 00 00 00 06 B2 15 00 60 00 00 
29 01 00 00 00 00 06 B3 15 00 60 00 00 
29 01 00 00 00 00 06 B4 05 00 60 00 00 
29 01 00 00 00 00 06 B5 05 00 60 00 00 
29 01 00 00 00 00 06 BA 44 10 60 01 90 
29 01 00 00 00 00 06 BB 44 10 60 01 90 
29 01 00 00 00 00 06 BC 44 10 60 01 90 
29 01 00 00 00 00 06 BD 44 10 60 01 90 
29 01 00 00 00 00 05 C0 00 34 00 00 
29 01 00 00 00 00 05 C1 00 00 34 00 
29 01 00 00 00 00 05 C2 00 00 34 00 
29 01 00 00 00 00 05 C3 00 00 34 00 
29 01 00 00 00 00 02 C4 60 
29 01 00 00 00 00 02 C5 C0 
29 01 00 00 00 00 02 C6 00 
29 01 00 00 00 00 02 C7 00 
29 01 00 00 00 00 06 F0 55 AA 52 08 05 
29 01 00 00 00 00 03 B0 17 06 
29 01 00 00 00 00 03 B1 17 06 
29 01 00 00 00 00 03 B2 17 06 
29 01 00 00 00 00 03 B3 17 06 
29 01 00 00 00 00 03 B4 17 06 
29 01 00 00 00 00 03 B5 17 06 
29 01 00 00 00 00 03 B6 14 03 
29 01 00 00 00 00 03 B7 00 00 
29 01 00 00 00 00 02 B8 0C 
29 01 00 00 00 00 03 B9 00 03 
29 01 00 00 00 00 03 BA 00 01 
29 01 00 00 00 00 03 BB 0A 03 
29 01 00 00 00 00 03 BC 02 03 
29 01 00 00 00 00 06 BD 03 03 01 03 03 
29 01 00 00 00 00 02 C0 07 
29 01 00 00 00 00 02 C1 06 
29 01 00 00 00 00 02 C2 A6 
29 01 00 00 00 00 02 C3 05 
29 01 00 00 00 00 02 C4 A6 
29 01 00 00 00 00 02 C5 A6 
29 01 00 00 00 00 02 C6 A6 
29 01 00 00 00 00 02 C7 A6 
29 01 00 00 00 00 03 C8 05 20 
29 01 00 00 00 00 03 C9 04 20 
29 01 00 00 00 00 03 CA 01 25 
29 01 00 00 00 00 03 CB 01 60 
29 01 00 00 00 00 04 CC 00 00 01 
29 01 00 00 00 00 04 CD 00 00 01 
29 01 00 00 00 00 04 CE 00 00 02 
29 01 00 00 00 00 04 CF 00 00 02 
29 01 00 00 00 00 08 D0 00 00 00 00 00 00 00 
29 01 00 00 00 00 06 D1 00 35 01 07 10 
29 01 00 00 00 00 06 D2 10 35 02 03 10 
29 01 00 00 00 00 06 D3 20 00 43 07 10 
29 01 00 00 00 00 06 D4 30 00 43 07 10 
29 01 00 00 00 00 0C D5 00 00 00 00 00 00 00 00 00 00 00 
29 01 00 00 00 00 0C D6 00 00 00 00 00 00 00 00 00 00 00 
29 01 00 00 00 00 0C D7 00 00 00 00 00 00 00 00 00 00 00 
29 01 00 00 00 00 06 D8 00 00 00 00 00 
29 01 00 00 00 00 02 E5 06 
29 01 00 00 00 00 02 E6 06 
29 01 00 00 00 00 02 E7 06 
29 01 00 00 00 00 02 E8 06 
29 01 00 00 00 00 02 E9 06 
29 01 00 00 00 00 02 EA 06 
29 01 00 00 00 00 02 EB 00 
29 01 00 00 00 00 02 EC 00 
29 01 00 00 00 00 02 ED 30 
29 01 00 00 00 00 06 F0 55 AA 52 08 06 
29 01 00 00 00 00 03 B5 10 13 
29 01 00 00 00 00 03 B6 12 11 
29 01 00 00 00 00 03 B7 00 01 
29 01 00 00 00 00 03 B8 08 31 
29 01 00 00 00 00 03 B9 31 31 
29 01 00 00 00 00 03 BA 31 31 
29 01 00 00 00 00 03 BB 31 08 
29 01 00 00 00 00 03 BC 03 02 
29 01 00 00 00 00 03 BD 17 18 
29 01 00 00 00 00 03 BE 19 16 
29 01 00 00 00 00 06 D8 00 00 00 00 00 
29 01 00 00 00 00 06 D9 00 00 00 00 00 
29 01 00 00 00 00 03 E5 00 00 
29 01 00 00 00 00 02 E7 00 
29 01 00 00 00 00 02 6F 01 
29 01 00 00 00 00 02 F9 46 
29 01 00 00 00 00 02 6F 11 
29 01 00 00 00 00 02 F3 01 
29 01 00 00 00 00 02 35 00 
29 01 00 00 00 00 02 51 00 
29 01 00 00 00 00 02 53 24 
29 01 00 00 00 00 02 55 93 // lijiangshuo modify CABC UI mode(01)-> Moving mode(03) 20140512  // MIDDLE CE 20140604
05 01 00 00 78 00 02 11 00 
05 01 00 00 14 00 02 29 00 ];
		qcom,mdss-dsi-off-command = [05 01 00 00 14 00 02 28 00 
05 01 00 00 0A 00 02 10 00 ];
		qcom,mdss-dsi-on-command-state = "dsi_lp_mode";
		qcom,mdss-dsi-off-command-state = "dsi_hs_mode";
		qcom,mdss-dsi-h-sync-pulse = <1>;
		qcom,mdss-dsi-traffic-mode = "burst_mode"; // <2>
		qcom,mdss-dsi-lane-map = <0>;
		qcom,mdss-dsi-bllp-eof-power-mode;
		qcom,mdss-dsi-bllp-power-mode;
		qcom,mdss-dsi-lane-0-state;
		qcom,mdss-dsi-lane-1-state;
		qcom,mdss-dsi-lane-2-state;
		qcom,mdss-dsi-lane-3-state;
		qcom,mdss-dsi-panel-timings = [87 1C 12 00 42 42 18 20 17 03 04 00];
		qcom,mdss-dsi-t-clk-post = <0x04>;
		qcom,mdss-dsi-t-clk-pre = <0x1A>;
		qcom,mdss-dsi-bl-min-level = <1>;
		qcom,mdss-dsi-bl-max-level = <255>;
		qcom,mdss-dsi-dma-trigger = <4>;
		qcom,mdss-dsi-mdp-trigger = "none"; // <0>
		qcom,mdss-dsi-bl-pmic-control-type = "bl_ctrl_dcs";
		qcom,mdss-dsi-reset-sequence = <1 20>, <0 2>, <1 20>;
		qcom,mdss-dsi-lp11-init; // wangzhe add for lp11_init 20140625
	};
};
