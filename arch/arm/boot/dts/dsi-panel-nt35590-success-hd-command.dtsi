/* Copyright (c) 2013, The Linux Foundation. All rights reserved.
 *
 * This program is free software; you can redistribute it and/or modify
 * it under the terms of the GNU General Public License version 2 and
 * only version 2 as published by the Free Software Foundation.
 *
 * This program is distributed in the hope that it will be useful,
 * but WITHOUT ANY WARRANTY; without even the implied warranty of
 * MERCHANTABILITY or FITNESS FOR A PARTICULAR PURPOSE.  See the
 * GNU General Public License for more details.
 */

/*---------------------------------------------------------------------------
 * This file is autogenerated file using gcdb parser. Please do not edit it.
 * Update input XML file to add a new entry or update variable in this file
 * VERSION = "1.0"
 *---------------------------------------------------------------------------*/
&mdss_mdp {
	dsi_nt35590_success_hd_command: qcom,mdss_dsi_nt35590_success_hd_command {
		qcom,mdss-dsi-panel-name = "nt35590 success hd command mode dsi panel";
        qcom,cont-splash-enabled;
		qcom,mdss-dsi-panel-controller = <&mdss_dsi0>;
		qcom,mdss-dsi-panel-type = "dsi_video_mode";
		qcom,mdss-dsi-panel-destination = "display_1";
		qcom,mdss-dsi-panel-framerate = <60>;
		qcom,mdss-dsi-virtual-channel-id = <0>;
		qcom,mdss-dsi-stream = <0>;
		qcom,mdss-dsi-panel-width = <720>;
		qcom,mdss-dsi-panel-height = <1280>;
		qcom,mdss-dsi-h-front-porch = <140>;
		qcom,mdss-dsi-h-back-porch = <140>;
		qcom,mdss-dsi-h-pulse-width = <8>;
		qcom,mdss-dsi-h-sync-skew = <0>;
		qcom,mdss-dsi-v-back-porch = <1>;
		qcom,mdss-dsi-v-front-porch = <10>;
		qcom,mdss-dsi-v-pulse-width = <1>;
		qcom,mdss-dsi-h-left-border = <0>;
		qcom,mdss-dsi-h-right-border = <0>;
		qcom,mdss-dsi-v-top-border = <0>;
		qcom,mdss-dsi-v-bottom-border = <0>;
		qcom,mdss-dsi-bpp = <24>;
		qcom,mdss-dsi-color-order = <0>;
		qcom,mdss-dsi-underflow-color = <0xff>;
		qcom,mdss-dsi-border-color = <0>;
		qcom,mdss-dsi-pixel-packing = <0>;
		qcom,mdss-dsi-pixel-alignment = <0>;
		qcom,mdss-dsi-on-command = [29 01 00 00 00 00 02 FF EE
					29 01 00 00 00 00 02 26 08
 					29 01 00 00 00 00 02 26 00
 					29 01 00 00 00 00 02 FF 00
 					29 01 00 00 00 00 02 FF 01
 					29 01 00 00 00 00 02 FB 01
 					29 01 00 00 00 00 02 00 4A
 					29 01 00 00 00 00 02 01 33
 					29 01 00 00 00 00 02 02 53
 					29 01 00 00 00 00 02 03 55
 					29 01 00 00 00 00 02 04 55
 					29 01 00 00 00 00 02 05 33
 					29 01 00 00 00 00 02 06 22
 					29 01 00 00 00 00 02 08 56
 					29 01 00 00 00 00 02 09 8F
 					29 01 00 00 00 00 02 0B CF
 					29 01 00 00 00 00 02 0C CF
 					29 01 00 00 00 00 02 0D 2F
 					29 01 00 00 00 00 02 0E 29
                                        29 01 00 00 00 00 02 11 83  //vcom
 					29 01 00 00 00 00 02 12 03 //
 					29 01 00 00 00 00 02 36 73
 					29 01 00 00 00 00 02 0F 0A
 					29 01 00 00 00 00 02 FF EE
 					29 01 00 00 00 00 02 FB 01
 					29 01 00 00 00 00 02 12 50
 					29 01 00 00 00 00 02 13 02
 					29 01 00 00 00 00 02 6A 60       
 					29 01 00 00 00 00 02 FF 05
 					29 01 00 00 00 00 02 FB 01
 					29 01 00 00 00 00 02 01 00
 					29 01 00 00 00 00 02 02 82
 					29 01 00 00 00 00 02 03 82
 					29 01 00 00 00 00 02 04 82
 					29 01 00 00 00 00 02 06 33
 					29 01 00 00 00 00 02 07 01
 					29 01 00 00 00 00 02 08 00
 					29 01 00 00 00 00 02 09 46
 					29 01 00 00 00 00 02 0A 46
 					29 01 00 00 00 00 02 0D 0B
 					29 01 00 00 00 00 02 0E 1D
 					29 01 00 00 00 00 02 0F 08
 					29 01 00 00 00 00 02 10 53
 					29 01 00 00 00 00 02 11 00
 					29 01 00 00 00 00 02 12 00
 					29 01 00 00 00 00 02 14 01
 					29 01 00 00 00 00 02 15 00
 					29 01 00 00 00 00 02 16 05
 					29 01 00 00 00 00 02 17 00
 					29 01 00 00 00 00 02 19 7F
 					29 01 00 00 00 00 02 1A FF
 					29 01 00 00 00 00 02 1B 0F
 					29 01 00 00 00 00 02 1C 00
 					29 01 00 00 00 00 02 1D 00
 					29 01 00 00 00 00 02 1E 00
 					29 01 00 00 00 00 02 1F 07
 					29 01 00 00 00 00 02 20 00
 					29 01 00 00 00 00 02 21 00
 					29 01 00 00 00 00 02 22 11
 					29 01 00 00 00 00 02 23 0D
 					29 01 00 00 00 00 02 2D 02
 					29 01 00 00 00 00 02 83 01
 					29 01 00 00 00 00 02 9E 58
 					29 01 00 00 00 00 02 9F 6A
 					29 01 00 00 00 00 02 A0 01
 					29 01 00 00 00 00 02 A2 10
 					29 01 00 00 00 00 02 BB 0A
 					29 01 00 00 00 00 02 BC 0A
 					29 01 00 00 00 00 02 28 01
 					29 01 00 00 00 00 02 2F 02
 					29 01 00 00 00 00 02 32 08
 					29 01 00 00 00 00 02 33 B8
 					29 01 00 00 00 00 02 36 01
 					29 01 00 00 00 00 02 37 00
 					29 01 00 00 00 00 02 43 00
 					29 01 00 00 00 00 02 4B 21
 					29 01 00 00 00 00 02 4C 03
 					29 01 00 00 00 00 02 50 21
 					29 01 00 00 00 00 02 51 03
 					29 01 00 00 00 00 02 58 21
 					29 01 00 00 00 00 02 59 03
 					29 01 00 00 00 00 02 5D 21
 					29 01 00 00 00 00 02 5E 03
 					29 01 00 00 00 00 02 6C 00
 					29 01 00 00 00 00 02 6D 00
 					/////=====gamma start
29 01 00 00 00 00 02 FF 01
29 01 00 00 00 00 02 75 00
29 01 00 00 00 00 02 76 41
29 01 00 00 00 00 02 77 00
29 01 00 00 00 00 02 78 A2
29 01 00 00 00 00 02 79 00
29 01 00 00 00 00 02 7A D1
29 01 00 00 00 00 02 7B 00
29 01 00 00 00 00 02 7C EB
29 01 00 00 00 00 02 7D 01
29 01 00 00 00 00 02 7E 01
29 01 00 00 00 00 02 7F 01
29 01 00 00 00 00 02 80 13
29 01 00 00 00 00 02 81 01
29 01 00 00 00 00 02 82 21
29 01 00 00 00 00 02 83 01
29 01 00 00 00 00 02 84 31
29 01 00 00 00 00 02 85 01
29 01 00 00 00 00 02 86 3D
29 01 00 00 00 00 02 87 01
29 01 00 00 00 00 02 88 69
29 01 00 00 00 00 02 89 01
29 01 00 00 00 00 02 8A 8A
29 01 00 00 00 00 02 8B 01
29 01 00 00 00 00 02 8C C0
29 01 00 00 00 00 02 8D 01
29 01 00 00 00 00 02 8E E9
29 01 00 00 00 00 02 8F 02
29 01 00 00 00 00 02 90 27
29 01 00 00 00 00 02 91 02
29 01 00 00 00 00 02 92 56
29 01 00 00 00 00 02 93 02
29 01 00 00 00 00 02 94 59
29 01 00 00 00 00 02 95 02
29 01 00 00 00 00 02 96 85
29 01 00 00 00 00 02 97 02
29 01 00 00 00 00 02 98 B3
29 01 00 00 00 00 02 99 02
29 01 00 00 00 00 02 9A D0
29 01 00 00 00 00 02 9B 02
29 01 00 00 00 00 02 9C F8
29 01 00 00 00 00 02 9D 03
29 01 00 00 00 00 02 9E 14
29 01 00 00 00 00 02 9F 03
29 01 00 00 00 00 02 A0 3A
29 01 00 00 00 00 02 A2 03
29 01 00 00 00 00 02 A3 45
29 01 00 00 00 00 02 A4 03
29 01 00 00 00 00 02 A5 47
29 01 00 00 00 00 02 A6 03
29 01 00 00 00 00 02 A7 48
29 01 00 00 00 00 02 A9 03
29 01 00 00 00 00 02 AA 49
29 01 00 00 00 00 02 AB 03
29 01 00 00 00 00 02 AC 6D
29 01 00 00 00 00 02 AD 03
29 01 00 00 00 00 02 AE 76
29 01 00 00 00 00 02 AF 03
29 01 00 00 00 00 02 B0 9A
29 01 00 00 00 00 02 B1 03
29 01 00 00 00 00 02 B2 A0
29 01 00 00 00 00 02 B3 00
29 01 00 00 00 00 02 B4 41
29 01 00 00 00 00 02 B5 00
29 01 00 00 00 00 02 B6 A2
29 01 00 00 00 00 02 B7 00
29 01 00 00 00 00 02 B8 D1
29 01 00 00 00 00 02 B9 00
29 01 00 00 00 00 02 BA EB
29 01 00 00 00 00 02 BB 01
29 01 00 00 00 00 02 BC 01
29 01 00 00 00 00 02 BD 01
29 01 00 00 00 00 02 BE 13
29 01 00 00 00 00 02 BF 01
29 01 00 00 00 00 02 C0 21
29 01 00 00 00 00 02 C1 01
29 01 00 00 00 00 02 C2 31
29 01 00 00 00 00 02 C3 01
29 01 00 00 00 00 02 C4 3D
29 01 00 00 00 00 02 C5 01
29 01 00 00 00 00 02 C6 69
29 01 00 00 00 00 02 C7 01
29 01 00 00 00 00 02 C8 8A
29 01 00 00 00 00 02 C9 01
29 01 00 00 00 00 02 CA C0
29 01 00 00 00 00 02 CB 01
29 01 00 00 00 00 02 CC E9
29 01 00 00 00 00 02 CD 02
29 01 00 00 00 00 02 CE 27
29 01 00 00 00 00 02 CF 02
29 01 00 00 00 00 02 D0 56
29 01 00 00 00 00 02 D1 02
29 01 00 00 00 00 02 D2 59
29 01 00 00 00 00 02 D3 02
29 01 00 00 00 00 02 D4 85
29 01 00 00 00 00 02 D5 02
29 01 00 00 00 00 02 D6 B3
29 01 00 00 00 00 02 D7 02
29 01 00 00 00 00 02 D8 D0
29 01 00 00 00 00 02 D9 02
29 01 00 00 00 00 02 DA F8
29 01 00 00 00 00 02 DB 03
29 01 00 00 00 00 02 DC 14
29 01 00 00 00 00 02 DD 03
29 01 00 00 00 00 02 DE 3A
29 01 00 00 00 00 02 DF 03
29 01 00 00 00 00 02 E0 45
29 01 00 00 00 00 02 E1 03
29 01 00 00 00 00 02 E2 47
29 01 00 00 00 00 02 E3 03
29 01 00 00 00 00 02 E4 48
29 01 00 00 00 00 02 E5 03
29 01 00 00 00 00 02 E6 49
29 01 00 00 00 00 02 E7 03
29 01 00 00 00 00 02 E8 6D
29 01 00 00 00 00 02 E9 03
29 01 00 00 00 00 02 EA 76
29 01 00 00 00 00 02 EB 03
29 01 00 00 00 00 02 EC 9A
29 01 00 00 00 00 02 ED 03
29 01 00 00 00 00 02 EE A0
29 01 00 00 00 00 02 EF 00
29 01 00 00 00 00 02 F0 B8
29 01 00 00 00 00 02 F1 00
29 01 00 00 00 00 02 F2 BC
29 01 00 00 00 00 02 F3 00
29 01 00 00 00 00 02 F4 D0
29 01 00 00 00 00 02 F5 00
29 01 00 00 00 00 02 F6 E4
29 01 00 00 00 00 02 F7 00
29 01 00 00 00 00 02 F8 F6
29 01 00 00 00 00 02 F9 01
29 01 00 00 00 00 02 FA 06
29 01 00 00 00 00 02 FF 02
29 01 00 00 00 00 02 00 01
29 01 00 00 00 00 02 01 15
29 01 00 00 00 00 02 02 01
29 01 00 00 00 00 02 03 22
29 01 00 00 00 00 02 04 01
29 01 00 00 00 00 02 05 2F
29 01 00 00 00 00 02 06 01
29 01 00 00 00 00 02 07 59
29 01 00 00 00 00 02 08 01
29 01 00 00 00 00 02 09 7C
29 01 00 00 00 00 02 0A 01
29 01 00 00 00 00 02 0B B2
29 01 00 00 00 00 02 0C 01
29 01 00 00 00 00 02 0D DD
29 01 00 00 00 00 02 0E 02
29 01 00 00 00 00 02 0F 1E
29 01 00 00 00 00 02 10 02
29 01 00 00 00 00 02 11 52
29 01 00 00 00 00 02 12 02
29 01 00 00 00 00 02 13 53
29 01 00 00 00 00 02 14 02
29 01 00 00 00 00 02 15 80
29 01 00 00 00 00 02 16 02
29 01 00 00 00 00 02 17 B1
29 01 00 00 00 00 02 18 02
29 01 00 00 00 00 02 19 D0
29 01 00 00 00 00 02 1A 02
29 01 00 00 00 00 02 1B FA
29 01 00 00 00 00 02 1C 03
29 01 00 00 00 00 02 1D 17
29 01 00 00 00 00 02 1E 03
29 01 00 00 00 00 02 1F 3D
29 01 00 00 00 00 02 20 03
29 01 00 00 00 00 02 21 49
29 01 00 00 00 00 02 22 03
29 01 00 00 00 00 02 23 5B
29 01 00 00 00 00 02 24 03
29 01 00 00 00 00 02 25 71
29 01 00 00 00 00 02 26 03
29 01 00 00 00 00 02 27 94
29 01 00 00 00 00 02 28 03
29 01 00 00 00 00 02 29 96
29 01 00 00 00 00 02 2A 03
29 01 00 00 00 00 02 2B D8
29 01 00 00 00 00 02 2D 03
29 01 00 00 00 00 02 2F FB
29 01 00 00 00 00 02 30 03
29 01 00 00 00 00 02 31 FC
29 01 00 00 00 00 02 32 00
29 01 00 00 00 00 02 33 B8
29 01 00 00 00 00 02 34 00
29 01 00 00 00 00 02 35 BC
29 01 00 00 00 00 02 36 00
29 01 00 00 00 00 02 37 D0
29 01 00 00 00 00 02 38 00
29 01 00 00 00 00 02 39 E4
29 01 00 00 00 00 02 3A 00
29 01 00 00 00 00 02 3B F6
29 01 00 00 00 00 02 3D 01
29 01 00 00 00 00 02 3F 06
29 01 00 00 00 00 02 40 01
29 01 00 00 00 00 02 41 15
29 01 00 00 00 00 02 42 01
29 01 00 00 00 00 02 43 22
29 01 00 00 00 00 02 44 01
29 01 00 00 00 00 02 45 2F
29 01 00 00 00 00 02 46 01
29 01 00 00 00 00 02 47 59
29 01 00 00 00 00 02 48 01
29 01 00 00 00 00 02 49 7C
29 01 00 00 00 00 02 4A 01
29 01 00 00 00 00 02 4B B2
29 01 00 00 00 00 02 4C 01
29 01 00 00 00 00 02 4D DD
29 01 00 00 00 00 02 4E 02
29 01 00 00 00 00 02 4F 1E
29 01 00 00 00 00 02 50 02
29 01 00 00 00 00 02 51 52
29 01 00 00 00 00 02 52 02
29 01 00 00 00 00 02 53 53
29 01 00 00 00 00 02 54 02
29 01 00 00 00 00 02 55 80
29 01 00 00 00 00 02 56 02
29 01 00 00 00 00 02 58 B1
29 01 00 00 00 00 02 59 02
29 01 00 00 00 00 02 5A D0
29 01 00 00 00 00 02 5B 02
29 01 00 00 00 00 02 5C FA
29 01 00 00 00 00 02 5D 03
29 01 00 00 00 00 02 5E 17
29 01 00 00 00 00 02 5F 03
29 01 00 00 00 00 02 60 3D
29 01 00 00 00 00 02 61 03
29 01 00 00 00 00 02 62 49
29 01 00 00 00 00 02 63 03
29 01 00 00 00 00 02 64 5B
29 01 00 00 00 00 02 65 03
29 01 00 00 00 00 02 66 71
29 01 00 00 00 00 02 67 03
29 01 00 00 00 00 02 68 94
29 01 00 00 00 00 02 69 03
29 01 00 00 00 00 02 6A 96
29 01 00 00 00 00 02 6B 03
29 01 00 00 00 00 02 6C D8
29 01 00 00 00 00 02 6D 03
29 01 00 00 00 00 02 6E FB
29 01 00 00 00 00 02 6F 03
29 01 00 00 00 00 02 70 FC
29 01 00 00 00 00 02 71 01
29 01 00 00 00 00 02 72 58
29 01 00 00 00 00 02 73 01
29 01 00 00 00 00 02 74 64
29 01 00 00 00 00 02 75 01
29 01 00 00 00 00 02 76 6F
29 01 00 00 00 00 02 77 01
29 01 00 00 00 00 02 78 76
29 01 00 00 00 00 02 79 01
29 01 00 00 00 00 02 7A 7D
29 01 00 00 00 00 02 7B 01
29 01 00 00 00 00 02 7C 83
29 01 00 00 00 00 02 7D 01
29 01 00 00 00 00 02 7E 8A
29 01 00 00 00 00 02 7F 01
29 01 00 00 00 00 02 80 90
29 01 00 00 00 00 02 81 01
29 01 00 00 00 00 02 82 96
29 01 00 00 00 00 02 83 01
29 01 00 00 00 00 02 84 AD
29 01 00 00 00 00 02 85 01
29 01 00 00 00 00 02 86 C1
29 01 00 00 00 00 02 87 01
29 01 00 00 00 00 02 88 E6
29 01 00 00 00 00 02 89 02
29 01 00 00 00 00 02 8A 04
29 01 00 00 00 00 02 8B 02
29 01 00 00 00 00 02 8C 38
29 01 00 00 00 00 02 8D 02
29 01 00 00 00 00 02 8E 63
29 01 00 00 00 00 02 8F 02
29 01 00 00 00 00 02 90 65
29 01 00 00 00 00 02 91 02
29 01 00 00 00 00 02 92 8E
29 01 00 00 00 00 02 93 02
29 01 00 00 00 00 02 94 BD
29 01 00 00 00 00 02 95 02
29 01 00 00 00 00 02 96 DE
29 01 00 00 00 00 02 97 03
29 01 00 00 00 00 02 98 0C
29 01 00 00 00 00 02 99 03
29 01 00 00 00 00 02 9A 31
29 01 00 00 00 00 02 9B 03
29 01 00 00 00 00 02 9C 7D
29 01 00 00 00 00 02 9D 03
29 01 00 00 00 00 02 9E DE
29 01 00 00 00 00 02 9F 03
29 01 00 00 00 00 02 A0 E3
29 01 00 00 00 00 02 A2 03
29 01 00 00 00 00 02 A3 FA
29 01 00 00 00 00 02 A4 03
29 01 00 00 00 00 02 A5 FE
29 01 00 00 00 00 02 A6 03
29 01 00 00 00 00 02 A7 FE
29 01 00 00 00 00 02 A9 03
29 01 00 00 00 00 02 AA FE
29 01 00 00 00 00 02 AB 03
29 01 00 00 00 00 02 AC FE
29 01 00 00 00 00 02 AD 03
29 01 00 00 00 00 02 AE FE
29 01 00 00 00 00 02 AF 01
29 01 00 00 00 00 02 B0 58
29 01 00 00 00 00 02 B1 01
29 01 00 00 00 00 02 B2 64
29 01 00 00 00 00 02 B3 01
29 01 00 00 00 00 02 B4 6F
29 01 00 00 00 00 02 B5 01
29 01 00 00 00 00 02 B6 76
29 01 00 00 00 00 02 B7 01
29 01 00 00 00 00 02 B8 7D
29 01 00 00 00 00 02 B9 01
29 01 00 00 00 00 02 BA 83
29 01 00 00 00 00 02 BB 01
29 01 00 00 00 00 02 BC 8A
29 01 00 00 00 00 02 BD 01
29 01 00 00 00 00 02 BE 90
29 01 00 00 00 00 02 BF 01
29 01 00 00 00 00 02 C0 96
29 01 00 00 00 00 02 C1 01
29 01 00 00 00 00 02 C2 AD
29 01 00 00 00 00 02 C3 01
29 01 00 00 00 00 02 C4 C1
29 01 00 00 00 00 02 C5 01
29 01 00 00 00 00 02 C6 E6
29 01 00 00 00 00 02 C7 02
29 01 00 00 00 00 02 C8 04
29 01 00 00 00 00 02 C9 02
29 01 00 00 00 00 02 CA 38
29 01 00 00 00 00 02 CB 02
29 01 00 00 00 00 02 CC 63
29 01 00 00 00 00 02 CD 02
29 01 00 00 00 00 02 CE 65
29 01 00 00 00 00 02 CF 02
29 01 00 00 00 00 02 D0 8E
29 01 00 00 00 00 02 D1 02
29 01 00 00 00 00 02 D2 BD
29 01 00 00 00 00 02 D3 02
29 01 00 00 00 00 02 D4 DE
29 01 00 00 00 00 02 D5 03
29 01 00 00 00 00 02 D6 0C
29 01 00 00 00 00 02 D7 03
29 01 00 00 00 00 02 D8 31
29 01 00 00 00 00 02 D9 03
29 01 00 00 00 00 02 DA 7D
29 01 00 00 00 00 02 DB 03
29 01 00 00 00 00 02 DC DE
29 01 00 00 00 00 02 DD 03
29 01 00 00 00 00 02 DE E3
29 01 00 00 00 00 02 DF 03
29 01 00 00 00 00 02 E0 FA
29 01 00 00 00 00 02 E1 03
29 01 00 00 00 00 02 E2 FE
29 01 00 00 00 00 02 E3 03
29 01 00 00 00 00 02 E4 FE
29 01 00 00 00 00 02 E5 03
29 01 00 00 00 00 02 E6 FE
29 01 00 00 00 00 02 E7 03
29 01 00 00 00 00 02 E8 FE
29 01 00 00 00 00 02 E9 03
29 01 00 00 00 00 02 EA FE
         /////=====gamma end
         
 					29 01 00 00 00 00 02 FF 00
 					29 01 00 00 00 00 02 FB 01
 					29 01 00 00 00 00 02 BA 03
 					29 01 00 00 00 00 02 C2 03       
// 					29 01 00 00 00 00 02 FF 03
// 					29 01 00 00 00 00 02 FE 08
// 					29 01 00 00 00 00 02 18 04
// 					29 01 00 00 00 00 02 19 0C
// 					29 01 00 00 00 00 02 1A 14
// 					29 01 00 00 00 00 02 25 26
// 					29 01 00 00 00 00 02 FB 01
 					
 					29 01 00 00 00 00 02 FF 00  
 					29 01 00 00 00 00 02 FB 01
 					//29 01 00 00 00 00 02 FE 01 					
 				  29 01 00 00 00 00 06 3B 03 01 05 94 8C 
 					29 01 00 00 00 00 02 3A 77 
 					29 01 00 00 00 00 02 35 00
          05 01 00 00 96 00 02 11 00
 					05 01 00 00 78 00 02 29 00];
		qcom,mdss-dsi-off-command = [05 01 00 00 32 00 02 28 00
					05 01 00 00 78 00 02 10 00];
		qcom,mdss-dsi-on-command-state = "dsi_lp_mode";
		qcom,mdss-dsi-off-command-state = "dsi_hs_mode";
		qcom,mdss-dsi-h-sync-pulse = <1>;
		qcom,mdss-dsi-traffic-mode = <2>;
		qcom,mdss-dsi-lane-map = <0>;
		qcom,mdss-dsi-bllp-eof-power-mode;
		qcom,mdss-dsi-bllp-power-mode;
		qcom,mdss-dsi-lane-0-state;
		qcom,mdss-dsi-lane-1-state;
		qcom,mdss-dsi-lane-2-state;
		qcom,mdss-dsi-lane-3-state;
//		qcom,mdss-dsi-te-pin-select = <1>;
//		qcom,mdss-dsi-te-v-sync-rd-ptr-irq-line = <0x2c>;
//		qcom,mdss-dsi-te-dcs-command = <1>;
//		qcom,mdss-dsi-te-check-enable;
//		qcom,mdss-dsi-te-using-te-pin;
		qcom,mdss-dsi-panel-timings = [7B 1A 10 00 3E 40 16 1C 15 03 04 00];
		qcom,mdss-dsi-t-clk-post = <0x04>;
		qcom,mdss-dsi-t-clk-pre = <0x1A>;
		qcom,mdss-dsi-bl-min-level = <1>;
		qcom,mdss-dsi-bl-max-level = <255>;
		qcom,mdss-dsi-dma-trigger = <4>;
		qcom,mdss-dsi-mdp-trigger = <0>;
		qcom,mdss-dsi-bl-pmic-control-type = "bl_ctrl_dcs";
		//qcom,mdss-dsi-reset-sequence = <1 20>, <0 2>, <1 20>;    
		qcom,mdss-dsi-reset-sequence = <1 20>, <0 60>, <1 120>;
        qcom,mdss-panel-id= "nt35590-success-hd-command";
	};
};
