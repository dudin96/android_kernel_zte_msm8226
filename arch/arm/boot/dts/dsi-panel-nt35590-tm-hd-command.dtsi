/* Copyright (c) 2013, The Linux Foundation. All rights reserved.
 *
 * This program is free software; you can redistribute it and/or modify
 * it under the terms of the GNU General Public License version 2 and
 * only version 2 as published by the Free Software Foundation.
 *
 * This program is distributed in the hope that it will be useful,
 * but WITHOUT ANY WARRANTY; without even the implied warranty of
 * MERCHANTABILITY or FITNESS FOR A PARTICULAR PURPOSE.  See the
 * GNU General Public License for more details.
 */

/*---------------------------------------------------------------------------
 * This file is autogenerated file using gcdb parser. Please do not edit it.
 * Update input XML file to add a new entry or update variable in this file
 * VERSION = "1.0"
 *---------------------------------------------------------------------------*/
&mdss_mdp {
	dsi_nt35590_tm_hd_command: qcom,mdss_dsi_nt35590_tm_hd_command {
		qcom,mdss-dsi-panel-name = "nt35590 tm hd command mode dsi panel";
        qcom,cont-splash-enabled;
		qcom,mdss-dsi-panel-controller = <&mdss_dsi0>;
		qcom,mdss-dsi-panel-type = "dsi_video_mode";
		qcom,mdss-dsi-panel-destination = "display_1";
		qcom,mdss-dsi-panel-framerate = <60>;
		qcom,mdss-dsi-virtual-channel-id = <0>;
		qcom,mdss-dsi-stream = <0>;
		qcom,mdss-dsi-panel-width = <720>;
		qcom,mdss-dsi-panel-height = <1280>;
		qcom,mdss-dsi-h-front-porch = <120>;
		qcom,mdss-dsi-h-back-porch = <120>;
		qcom,mdss-dsi-h-pulse-width = <7>;
		qcom,mdss-dsi-h-sync-skew = <0>;
		qcom,mdss-dsi-v-back-porch = <8>;
		qcom,mdss-dsi-v-front-porch = <10>;
		qcom,mdss-dsi-v-pulse-width = <4>;
		qcom,mdss-dsi-h-left-border = <0>;
		qcom,mdss-dsi-h-right-border = <0>;
		qcom,mdss-dsi-v-top-border = <0>;
		qcom,mdss-dsi-v-bottom-border = <0>;
		qcom,mdss-dsi-bpp = <24>;
		qcom,mdss-dsi-color-order = <0>;
		qcom,mdss-dsi-underflow-color = <0xff>;
		qcom,mdss-dsi-border-color = <0>;
		qcom,mdss-dsi-pixel-packing = <0>;
		qcom,mdss-dsi-pixel-alignment = <0>;
		qcom,mdss-dsi-on-command = [29 01 00 00 00 00 02 FF 00
					29 01 00 00 00 00 02 FB 01
					29 01 00 00 00 00 06 3B 03 06 03 02 02
					29 01 00 00 00 00 02 FF 01
					29 01 00 00 00 00 02 FB 01
					29 01 00 00 00 00 02 00 3A
					29 01 00 00 00 00 02 01 33
					29 01 00 00 00 00 02 02 53
					29 01 00 00 00 00 02 03 53
					29 01 00 00 00 00 02 04 55
					29 01 00 00 00 00 02 05 33
					29 01 00 00 00 00 02 06 22
					29 01 00 00 00 00 02 08 66
					29 01 00 00 00 00 02 09 0F
					29 01 00 00 00 00 02 0B C2
					29 01 00 00 00 00 02 0C C2
					29 01 00 00 00 00 02 0D 24
					29 01 00 00 00 00 02 0E 33
					29 01 00 00 00 00 02 11 93
					29 01 00 00 00 00 02 12 03
					29 01 00 00 00 00 02 0F 0A
					29 01 00 00 00 00 02 36 73
					29 01 00 00 00 00 02 71 2C
					29 01 00 00 00 00 02 FF 05
					29 01 00 00 00 00 02 FB 01
					29 01 00 00 00 00 02 01 00
					29 01 00 00 00 00 02 02 8D
					29 01 00 00 00 00 02 03 8D
					29 01 00 00 00 00 02 04 8D
					29 01 00 00 00 00 02 05 30
					29 01 00 00 00 00 02 06 33
					29 01 00 00 00 00 02 07 77
					29 01 00 00 00 00 02 08 00
					29 01 00 00 00 00 02 09 00
					29 01 00 00 00 00 02 0A 00
					29 01 00 00 00 00 02 0B 80
					29 01 00 00 00 00 02 0C C8
					29 01 00 00 00 00 02 0D 0A
					29 01 00 00 00 00 02 0E 1B
					29 01 00 00 00 00 02 0F 06
					29 01 00 00 00 00 02 10 56
					29 01 00 00 00 00 02 11 00
					29 01 00 00 00 00 02 12 00
					29 01 00 00 00 00 02 13 1E
					29 01 00 00 00 00 02 14 00
					29 01 00 00 00 00 02 15 1A
					29 01 00 00 00 00 02 16 05
					29 01 00 00 00 00 02 17 00
					29 01 00 00 00 00 02 18 1E
					29 01 00 00 00 00 02 19 FF
					29 01 00 00 00 00 02 1A 00
					29 01 00 00 00 00 02 1B FC
					29 01 00 00 00 00 02 1C 80
					29 01 00 00 00 00 02 1D 00
					29 01 00 00 00 00 02 1E 00
					29 01 00 00 00 00 02 1F 77
					29 01 00 00 00 00 02 20 00
					29 01 00 00 00 00 02 21 00
					29 01 00 00 00 00 02 22 55
					29 01 00 00 00 00 02 23 0D
					29 01 00 00 00 00 02 31 A0
					29 01 00 00 00 00 02 32 00
					29 01 00 00 00 00 02 33 B8
					29 01 00 00 00 00 02 34 BB
					29 01 00 00 00 00 02 35 11
					29 01 00 00 00 00 02 36 02
					29 01 00 00 00 00 02 37 00
					29 01 00 00 00 00 02 38 01
					29 01 00 00 00 00 02 39 0B
					29 01 00 00 00 00 02 44 08
					29 01 00 00 00 00 02 45 80
					29 01 00 00 00 00 02 46 CC
					29 01 00 00 00 00 02 47 04
					29 01 00 00 00 00 02 48 00
					29 01 00 00 00 00 02 49 00
					29 01 00 00 00 00 02 4A 01
					29 01 00 00 00 00 02 6C 03
					29 01 00 00 00 00 02 6D 03
					29 01 00 00 00 00 02 6E 2F
					29 01 00 00 00 00 02 43 00
					29 01 00 00 00 00 02 4B 23
					29 01 00 00 00 00 02 4C 01
					29 01 00 00 00 00 02 50 23
					29 01 00 00 00 00 02 51 01
					29 01 00 00 00 00 02 58 23
					29 01 00 00 00 00 02 59 01
					29 01 00 00 00 00 02 5D 23
					29 01 00 00 00 00 02 5E 01
					29 01 00 00 00 00 02 89 00
					29 01 00 00 00 00 02 8D 01
					29 01 00 00 00 00 02 8E 64
					29 01 00 00 00 00 02 8F 20
					29 01 00 00 00 00 02 97 8E
					29 01 00 00 00 00 02 82 8C
					29 01 00 00 00 00 02 83 02
					29 01 00 00 00 00 02 BB 0A
					29 01 00 00 00 00 02 BC 0A
					29 01 00 00 00 00 02 24 25
					29 01 00 00 00 00 02 25 55
					29 01 00 00 00 00 02 26 05
					29 01 00 00 00 00 02 27 23
					29 01 00 00 00 00 02 28 01
					29 01 00 00 00 00 02 29 31
					29 01 00 00 00 00 02 2A 5D
					29 01 00 00 00 00 02 2B 01
					29 01 00 00 00 00 02 2F 00
					29 01 00 00 00 00 02 30 10
					29 01 00 00 00 00 02 A7 12
					29 01 00 00 00 00 02 2D 03
					29 01 00 00 00 00 02 FF 00
					29 01 00 00 00 00 02 FF 01
					29 01 00 00 00 00 02 75 00
					29 01 00 00 00 00 02 76 72
					29 01 00 00 00 00 02 77 00
					29 01 00 00 00 00 02 78 82
					29 01 00 00 00 00 02 79 00
					29 01 00 00 00 00 02 7A AC
					29 01 00 00 00 00 02 7B 00
					29 01 00 00 00 00 02 7C C8
					29 01 00 00 00 00 02 7D 00
					29 01 00 00 00 00 02 7E E2
					29 01 00 00 00 00 02 7F 00
					29 01 00 00 00 00 02 80 F4
					29 01 00 00 00 00 02 81 00
					29 01 00 00 00 00 02 82 FE
					29 01 00 00 00 00 02 83 01
					29 01 00 00 00 00 02 84 08
					29 01 00 00 00 00 02 85 01
					29 01 00 00 00 00 02 86 16
					29 01 00 00 00 00 02 87 01
					29 01 00 00 00 00 02 88 44
					29 01 00 00 00 00 02 89 01
					29 01 00 00 00 00 02 8A 64
					29 01 00 00 00 00 02 8B 01
					29 01 00 00 00 00 02 8C 9C
					29 01 00 00 00 00 02 8D 01
					29 01 00 00 00 00 02 8E C6
					29 01 00 00 00 00 02 8F 02
					29 01 00 00 00 00 02 90 08
					29 01 00 00 00 00 02 91 02
					29 01 00 00 00 00 02 92 40
					29 01 00 00 00 00 02 93 02
					29 01 00 00 00 00 02 94 41
					29 01 00 00 00 00 02 95 02
					29 01 00 00 00 00 02 96 75
					29 01 00 00 00 00 02 97 02
					29 01 00 00 00 00 02 98 AC
					29 01 00 00 00 00 02 99 02
					29 01 00 00 00 00 02 9A D1
					29 01 00 00 00 00 02 9B 03
					29 01 00 00 00 00 02 9C 01
					29 01 00 00 00 00 02 9D 03
					29 01 00 00 00 00 02 9E 23
					29 01 00 00 00 00 02 9F 03
					29 01 00 00 00 00 02 A0 45
					29 01 00 00 00 00 02 A2 03
					29 01 00 00 00 00 02 A3 55
					29 01 00 00 00 00 02 A4 03
					29 01 00 00 00 00 02 A5 62
					29 01 00 00 00 00 02 A6 03
					29 01 00 00 00 00 02 A7 73
					29 01 00 00 00 00 02 A9 03
					29 01 00 00 00 00 02 AA 86
					29 01 00 00 00 00 02 AB 03
					29 01 00 00 00 00 02 AC 93
					29 01 00 00 00 00 02 AD 03
					29 01 00 00 00 00 02 AE 98
					29 01 00 00 00 00 02 AF 03
					29 01 00 00 00 00 02 B0 B6
					29 01 00 00 00 00 02 B1 03
					29 01 00 00 00 00 02 B2 C5
					29 01 00 00 00 00 02 B3 00
					29 01 00 00 00 00 02 B4 72
					29 01 00 00 00 00 02 B5 00
					29 01 00 00 00 00 02 B6 82
					29 01 00 00 00 00 02 B7 00
					29 01 00 00 00 00 02 B8 AC
					29 01 00 00 00 00 02 B9 00
					29 01 00 00 00 00 02 BA C8
					29 01 00 00 00 00 02 BB 00
					29 01 00 00 00 00 02 BC E2
					29 01 00 00 00 00 02 BD 00
					29 01 00 00 00 00 02 BE F4
					29 01 00 00 00 00 02 BF 00
					29 01 00 00 00 00 02 C0 FE
					29 01 00 00 00 00 02 C1 01
					29 01 00 00 00 00 02 C2 08
					29 01 00 00 00 00 02 C3 01
					29 01 00 00 00 00 02 C4 16
					29 01 00 00 00 00 02 C5 01
					29 01 00 00 00 00 02 C6 44
					29 01 00 00 00 00 02 C7 01
					29 01 00 00 00 00 02 C8 64
					29 01 00 00 00 00 02 C9 01
					29 01 00 00 00 00 02 CA 9C
					29 01 00 00 00 00 02 CB 01
					29 01 00 00 00 00 02 CC C6
					29 01 00 00 00 00 02 CD 02
					29 01 00 00 00 00 02 CE 08
					29 01 00 00 00 00 02 CF 02
					29 01 00 00 00 00 02 D0 40
					29 01 00 00 00 00 02 D1 02
					29 01 00 00 00 00 02 D2 41
					29 01 00 00 00 00 02 D3 02
					29 01 00 00 00 00 02 D4 75
					29 01 00 00 00 00 02 D5 02
					29 01 00 00 00 00 02 D6 AC
					29 01 00 00 00 00 02 D7 02
					29 01 00 00 00 00 02 D8 D1
					29 01 00 00 00 00 02 D9 03
					29 01 00 00 00 00 02 DA 01
					29 01 00 00 00 00 02 DB 03
					29 01 00 00 00 00 02 DC 23
					29 01 00 00 00 00 02 DD 03
					29 01 00 00 00 00 02 DE 45
					29 01 00 00 00 00 02 DF 03
					29 01 00 00 00 00 02 E0 55
					29 01 00 00 00 00 02 E1 03
					29 01 00 00 00 00 02 E2 62
					29 01 00 00 00 00 02 E3 03
					29 01 00 00 00 00 02 E4 73
					29 01 00 00 00 00 02 E5 03
					29 01 00 00 00 00 02 E6 86
					29 01 00 00 00 00 02 E7 03
					29 01 00 00 00 00 02 E8 93
					29 01 00 00 00 00 02 E9 03
					29 01 00 00 00 00 02 EA 98
					29 01 00 00 00 00 02 EB 03
					29 01 00 00 00 00 02 EC B6
					29 01 00 00 00 00 02 ED 03
					29 01 00 00 00 00 02 EE C5
					29 01 00 00 00 00 02 EF 00
					29 01 00 00 00 00 02 F0 72
					29 01 00 00 00 00 02 F1 00
					29 01 00 00 00 00 02 F2 82
					29 01 00 00 00 00 02 F3 00
					29 01 00 00 00 00 02 F4 AC
					29 01 00 00 00 00 02 F5 00
					29 01 00 00 00 00 02 F6 C8
					29 01 00 00 00 00 02 F7 00
					29 01 00 00 00 00 02 F8 E2
					29 01 00 00 00 00 02 F9 00
					29 01 00 00 00 00 02 FA F4
					29 01 00 00 00 00 02 FF 00
					29 01 00 00 00 00 02 FF 02
					29 01 00 00 00 00 02 00 00
					29 01 00 00 00 00 02 01 FE
					29 01 00 00 00 00 02 02 01
					29 01 00 00 00 00 02 03 08
					29 01 00 00 00 00 02 04 01
					29 01 00 00 00 00 02 05 16
					29 01 00 00 00 00 02 06 01
					29 01 00 00 00 00 02 07 44
					29 01 00 00 00 00 02 08 01
					29 01 00 00 00 00 02 09 64
					29 01 00 00 00 00 02 0A 01
					29 01 00 00 00 00 02 0B 9C
					29 01 00 00 00 00 02 0C 01
					29 01 00 00 00 00 02 0D C6
					29 01 00 00 00 00 02 0E 02
					29 01 00 00 00 00 02 0F 08
					29 01 00 00 00 00 02 10 02
					29 01 00 00 00 00 02 11 40
					29 01 00 00 00 00 02 12 02
					29 01 00 00 00 00 02 13 41
					29 01 00 00 00 00 02 14 02
					29 01 00 00 00 00 02 15 75
					29 01 00 00 00 00 02 16 02
					29 01 00 00 00 00 02 17 AC
					29 01 00 00 00 00 02 18 02
					29 01 00 00 00 00 02 19 D1
					29 01 00 00 00 00 02 1A 03
					29 01 00 00 00 00 02 1B 01
					29 01 00 00 00 00 02 1C 03
					29 01 00 00 00 00 02 1D 23
					29 01 00 00 00 00 02 AE 03
					29 01 00 00 00 00 02 1F 45
					29 01 00 00 00 00 02 20 03
					29 01 00 00 00 00 02 21 55
					29 01 00 00 00 00 02 22 03
					29 01 00 00 00 00 02 23 62
					29 01 00 00 00 00 02 24 03
					29 01 00 00 00 00 02 25 73
					29 01 00 00 00 00 02 26 03
					29 01 00 00 00 00 02 27 86
					29 01 00 00 00 00 02 28 03
					29 01 00 00 00 00 02 29 93
					29 01 00 00 00 00 02 2A 03
					29 01 00 00 00 00 02 2B 98
					29 01 00 00 00 00 02 2D 03
					29 01 00 00 00 00 02 2F B6
					29 01 00 00 00 00 02 30 03
					29 01 00 00 00 00 02 31 C5
					29 01 00 00 00 00 02 32 00
					29 01 00 00 00 00 02 33 72
					29 01 00 00 00 00 02 34 00
					29 01 00 00 00 00 02 35 82
					29 01 00 00 00 00 02 36 00
					29 01 00 00 00 00 02 37 AC
					29 01 00 00 00 00 02 38 00
					29 01 00 00 00 00 02 39 C8
					29 01 00 00 00 00 02 3A 00
					29 01 00 00 00 00 02 3B E2
					29 01 00 00 00 00 02 3D 00
					29 01 00 00 00 00 02 3F F4
					29 01 00 00 00 00 02 40 00
					29 01 00 00 00 00 02 41 FE
					29 01 00 00 00 00 02 42 01
					29 01 00 00 00 00 02 43 08
					29 01 00 00 00 00 02 44 01
					29 01 00 00 00 00 02 45 16
					29 01 00 00 00 00 02 46 01
					29 01 00 00 00 00 02 47 44
					29 01 00 00 00 00 02 48 01
					29 01 00 00 00 00 02 49 64
					29 01 00 00 00 00 02 4A 01
					29 01 00 00 00 00 02 4B 9C
					29 01 00 00 00 00 02 4C 01
					29 01 00 00 00 00 02 4D C6
					29 01 00 00 00 00 02 4E 02
					29 01 00 00 00 00 02 4F 08
					29 01 00 00 00 00 02 50 02
					29 01 00 00 00 00 02 51 40
					29 01 00 00 00 00 02 52 02
					29 01 00 00 00 00 02 53 41
					29 01 00 00 00 00 02 54 02
					29 01 00 00 00 00 02 55 75
					29 01 00 00 00 00 02 56 02
					29 01 00 00 00 00 02 58 AC
					29 01 00 00 00 00 02 59 02
					29 01 00 00 00 00 02 5A D1
					29 01 00 00 00 00 02 5B 03
					29 01 00 00 00 00 02 5C 01
					29 01 00 00 00 00 02 5D 03
					29 01 00 00 00 00 02 5E 23
					29 01 00 00 00 00 02 5F 03
					29 01 00 00 00 00 02 60 45
					29 01 00 00 00 00 02 61 03
					29 01 00 00 00 00 02 62 55
					29 01 00 00 00 00 02 63 03
					29 01 00 00 00 00 02 64 62
					29 01 00 00 00 00 02 65 03
					29 01 00 00 00 00 02 66 73
					29 01 00 00 00 00 02 67 03
					29 01 00 00 00 00 02 68 86
					29 01 00 00 00 00 02 69 03
					29 01 00 00 00 00 02 6A 93
					29 01 00 00 00 00 02 6B 03
					29 01 00 00 00 00 02 6C 98
					29 01 00 00 00 00 02 6D 03
					29 01 00 00 00 00 02 6E B6
					29 01 00 00 00 00 02 6F 03
					29 01 00 00 00 00 02 70 C5
					29 01 00 00 00 00 02 71 00
					29 01 00 00 00 00 02 72 72
					29 01 00 00 00 00 02 73 00
					29 01 00 00 00 00 02 74 82
					29 01 00 00 00 00 02 75 00
					29 01 00 00 00 00 02 76 AC
					29 01 00 00 00 00 02 77 00
					29 01 00 00 00 00 02 78 C8
					29 01 00 00 00 00 02 79 00
					29 01 00 00 00 00 02 7A E2
					29 01 00 00 00 00 02 7B 00
					29 01 00 00 00 00 02 7C F4
					29 01 00 00 00 00 02 7D 00
					29 01 00 00 00 00 02 7E FE
					29 01 00 00 00 00 02 7F 01
					29 01 00 00 00 00 02 80 08
					29 01 00 00 00 00 02 81 01
					29 01 00 00 00 00 02 82 16
					29 01 00 00 00 00 02 83 01
					29 01 00 00 00 00 02 84 44
					29 01 00 00 00 00 02 85 01
					29 01 00 00 00 00 02 86 64
					29 01 00 00 00 00 02 87 01
					29 01 00 00 00 00 02 88 9C
					29 01 00 00 00 00 02 89 01
					29 01 00 00 00 00 02 8A C6
					29 01 00 00 00 00 02 8B 02
					29 01 00 00 00 00 02 8C 08
					29 01 00 00 00 00 02 8D 02
					29 01 00 00 00 00 02 8E 40
					29 01 00 00 00 00 02 8F 02
					29 01 00 00 00 00 02 90 41
					29 01 00 00 00 00 02 91 02
					29 01 00 00 00 00 02 92 75
					29 01 00 00 00 00 02 93 02
					29 01 00 00 00 00 02 94 AC
					29 01 00 00 00 00 02 95 02
					29 01 00 00 00 00 02 96 D1
					29 01 00 00 00 00 02 97 03
					29 01 00 00 00 00 02 98 01
					29 01 00 00 00 00 02 99 03
					29 01 00 00 00 00 02 9A 23
					29 01 00 00 00 00 02 9B 03
					29 01 00 00 00 00 02 9C 45
					29 01 00 00 00 00 02 9D 03
					29 01 00 00 00 00 02 9E 55
					29 01 00 00 00 00 02 9F 03
					29 01 00 00 00 00 02 A0 62
					29 01 00 00 00 00 02 A2 03
					29 01 00 00 00 00 02 A3 73
					29 01 00 00 00 00 02 A4 03
					29 01 00 00 00 00 02 A5 86
					29 01 00 00 00 00 02 A6 03
					29 01 00 00 00 00 02 A7 93
					29 01 00 00 00 00 02 A9 03
					29 01 00 00 00 00 02 AA 98
					29 01 00 00 00 00 02 AB 03
					29 01 00 00 00 00 02 AC B6
					29 01 00 00 00 00 02 AD 03
					29 01 00 00 00 00 02 AE C5
					29 01 00 00 00 00 02 AF 00
					29 01 00 00 00 00 02 B0 72
					29 01 00 00 00 00 02 B1 00
					29 01 00 00 00 00 02 B2 82
					29 01 00 00 00 00 02 B3 00
					29 01 00 00 00 00 02 B4 AC
					29 01 00 00 00 00 02 B5 00
					29 01 00 00 00 00 02 B6 C8
					29 01 00 00 00 00 02 B7 00
					29 01 00 00 00 00 02 B8 E2
					29 01 00 00 00 00 02 B9 00
					29 01 00 00 00 00 02 BA F4
					29 01 00 00 00 00 02 BB 00
					29 01 00 00 00 00 02 BC FE
					29 01 00 00 00 00 02 BD 01
					29 01 00 00 00 00 02 BE 08
					29 01 00 00 00 00 02 BF 01
					29 01 00 00 00 00 02 C0 16
					29 01 00 00 00 00 02 C1 01
					29 01 00 00 00 00 02 C2 44
					29 01 00 00 00 00 02 C3 01
					29 01 00 00 00 00 02 C4 64
					29 01 00 00 00 00 02 C5 01
					29 01 00 00 00 00 02 C6 9C
					29 01 00 00 00 00 02 C7 01
					29 01 00 00 00 00 02 C8 C6
					29 01 00 00 00 00 02 C9 02
					29 01 00 00 00 00 02 CA 08
					29 01 00 00 00 00 02 CB 02
					29 01 00 00 00 00 02 CC 40
					29 01 00 00 00 00 02 CD 02
					29 01 00 00 00 00 02 CE 41
					29 01 00 00 00 00 02 CF 02
					29 01 00 00 00 00 02 D0 75
					29 01 00 00 00 00 02 D1 02
					29 01 00 00 00 00 02 D2 AC
					29 01 00 00 00 00 02 D3 02
					29 01 00 00 00 00 02 D4 D1
					29 01 00 00 00 00 02 D5 03
					29 01 00 00 00 00 02 D6 01
					29 01 00 00 00 00 02 D7 03
					29 01 00 00 00 00 02 D8 23
					29 01 00 00 00 00 02 D9 03
					29 01 00 00 00 00 02 DA 45
					29 01 00 00 00 00 02 DB 03
					29 01 00 00 00 00 02 DC 55
					29 01 00 00 00 00 02 DD 03
					29 01 00 00 00 00 02 DE 62
					29 01 00 00 00 00 02 DF 03
					29 01 00 00 00 00 02 E0 73
					29 01 00 00 00 00 02 E1 03
					29 01 00 00 00 00 02 E2 86
					29 01 00 00 00 00 02 E3 03
					29 01 00 00 00 00 02 E4 93
					29 01 00 00 00 00 02 E5 03
					29 01 00 00 00 00 02 E6 98
					29 01 00 00 00 00 02 E7 03
					29 01 00 00 00 00 02 E8 B6
					29 01 00 00 00 00 02 E9 03
					29 01 00 00 00 00 02 EA C5		                                                          
					29 01 00 00 00 00 02 FF 04
					29 01 00 00 00 00 02 00 01
					29 01 00 00 00 00 02 0A 08	                                                            
					29 01 00 00 00 00 02 FF 00
					29 01 00 00 00 00 02 FB 01
					29 01 00 00 00 00 02 C2 03
					29 01 00 00 00 00 02 BA 03                                  
					29 01 00 00 00 00 02 FF 04
					29 01 00 00 00 00 02 00 01
					29 01 00 00 00 00 02 0A 08                            
					29 01 00 00 00 00 02 FF 00
					29 01 00 00 00 00 02 FB 01
					29 01 00 00 00 00 02 C2 03
					29 01 00 00 00 00 02 BA 03
            				05 01 00 00 96 00 02 11 00
 					05 01 00 00 78 00 02 29 00];
		qcom,mdss-dsi-off-command = [05 01 00 00 32 00 02 28 00
					05 01 00 00 78 00 02 10 00];
		qcom,mdss-dsi-on-command-state = "dsi_lp_mode";
		qcom,mdss-dsi-off-command-state = "dsi_hs_mode";
		qcom,mdss-dsi-h-sync-pulse = <1>;
		qcom,mdss-dsi-traffic-mode = <2>;
		qcom,mdss-dsi-lane-map = <0>;
		qcom,mdss-dsi-bllp-eof-power-mode;
		qcom,mdss-dsi-bllp-power-mode;
		qcom,mdss-dsi-lane-0-state;
		qcom,mdss-dsi-lane-1-state;
		qcom,mdss-dsi-lane-2-state;
		qcom,mdss-dsi-lane-3-state;
		qcom,mdss-dsi-te-pin-select = <1>;
		qcom,mdss-dsi-te-v-sync-rd-ptr-irq-line = <0x2c>;
		qcom,mdss-dsi-te-dcs-command = <1>;
		qcom,mdss-dsi-te-check-enable;
		qcom,mdss-dsi-te-using-te-pin;
		qcom,mdss-dsi-panel-timings = [87 1C 12 00 42 42 18 20 17 03 04 00];
		qcom,mdss-dsi-t-clk-post = <0x04>;
		qcom,mdss-dsi-t-clk-pre = <0x1B>;
		qcom,mdss-dsi-bl-min-level = <1>;
		qcom,mdss-dsi-bl-max-level = <255>;
		qcom,mdss-dsi-dma-trigger = <4>;
		qcom,mdss-dsi-mdp-trigger = <0>;
		qcom,mdss-dsi-bl-pmic-control-type = "bl_ctrl_dcs";
		qcom,mdss-dsi-reset-sequence = <1 20>, <0 2>, <1 20>;
        qcom,mdss-panel-id= "nt35590-tm-hd-command";
	};
};
