/* Copyright (c) 2013, The Linux Foundation. All rights reserved.
 *
 * This program is free software; you can redistribute it and/or modify
 * it under the terms of the GNU General Public License version 2 and
 * only version 2 as published by the Free Software Foundation.
 *
 * This program is distributed in the hope that it will be useful,
 * but WITHOUT ANY WARRANTY; without even the implied warranty of
 * MERCHANTABILITY or FITNESS FOR A PARTICULAR PURPOSE.  See the
 * GNU General Public License for more details.
 */

qcom,zte-4v35-2300mAh-data {
	qcom,fcc-mah = <2300>;
	qcom,default-rbatt-mohm = <188>;
	qcom,rbatt-capacitive-mohm = <0>;
	qcom,flat-ocv-threshold-uv = <3800000>;
	qcom,max-voltage-uv = <4350000>;
	qcom,v-cutoff-uv = <3400000>;
	qcom,chg-term-ua = <100000>;
	qcom,batt-id-kohm = <110>;

	qcom,rbatt-sf-lut {
		qcom,lut-col-legend = <(-20) 0 25 40 60>;
		qcom,lut-row-legend = <100 95 90 85 80>,
				<75 70 65 60 55>,
				<50 45 40 35 30>,
				<25 20 15 10 9>,
				<8 7 6 5 4>,
				<3 2 1 0>;
		qcom,lut-data = <684 244 100 71 65>,
				<683 244 100 71 65>,
				<652 247 104 74 67>,
				<627 244 107 77 69>,
				<619 242 111 79 71>,
				<610 250 115 83 73>,
				<588 237 113 85 75>,
				<597 242 111 88 78>,
				<606 246 103 85 78>,
				<614 243 102 74 68>,
				<628 243 102 74 68>,
				<649 244 105 76 70>,
				<679 244 107 78 73>,
				<726 246 109 81 76>,
				<801 256 110 82 74>,
				<893 270 111 80 70>,
				<1009 290 107 78 70>,
				<1167 320 102 76 70>,
				<660 263 104 77 70>,
				<689 265 106 78 72>,
				<726 269 109 80 75>,
				<771 272 112 83 77>,
				<823 275 112 84 75>,
				<894 276 108 79 71>,
				<993 280 106 77 71>,
				<1211 288 108 79 73>,
				<2403 301 117 84 77>,
				<10946 404 934 97 122>,
				<60347 42812 35216 41540 36756>;
	};

	qcom,fcc-temp-lut {
		qcom,lut-col-legend = <(-20) 0 25 40 60>;
		qcom,lut-data = <2332 2334 2349 2342 2335>;
	};

	qcom,pc-temp-ocv-lut {
		qcom,lut-col-legend = <(-20) 0 25 40 60>;
		qcom,lut-row-legend = <100 95 90 85 80>,
				<75 70 65 60 55>,
				<50 45 40 35 30>,
				<25 20 15 10 9>,
				<8 7 6 5 4>,
				<3 2 1 0>;
		qcom,lut-data = <4324 4322 4317 4316 4309>,
				<4237 4250 4251 4252 4248>,
				<4173 4192 4197 4199 4196>,
				<4116 4136 4146 4148 4145>,
				<4070 4082 4098 4099 4096>,
				<4013 4042 4058 4054 4050>,
				<3931 3959 3991 4003 4007>,
				<3892 3921 3951 3969 3968>,
				<3860 3896 3908 3928 3928>,
				<3830 3865 3873 3876 3876>,
				<3804 3837 3844 3847 3847>,
				<3782 3810 3821 3823 3824>,
				<3764 3785 3802 3803 3804>,
				<3748 3763 3785 3787 3787>,
				<3733 3748 3770 3772 3767>,
				<3717 3736 3755 3754 3742>,
				<3699 3725 3730 3730 3717>,
				<3674 3713 3702 3700 3687>,
				<3637 3698 3689 3681 3669>,
				<3626 3692 3687 3680 3668>,
				<3613 3684 3685 3679 3667>,
				<3597 3674 3680 3676 3663>,
				<3576 3658 3667 3668 3651>,
				<3551 3633 3635 3639 3618>,
				<3515 3597 3585 3590 3568>,
				<3465 3547 3516 3525 3502>,
				<3393 3476 3417 3434 3408>,
				<3298 3363 3262 3283 3248>,
				<3000 3000 3000 3000 3000>;
	};
};
