/* Copyright (c) 2013, The Linux Foundation. All rights reserved.
 *
 * This program is free software; you can redistribute it and/or modify
 * it under the terms of the GNU General Public License version 2 and
 * only version 2 as published by the Free Software Foundation.
 *
 * This program is distributed in the hope that it will be useful,
 * but WITHOUT ANY WARRANTY; without even the implied warranty of
 * MERCHANTABILITY or FITNESS FOR A PARTICULAR PURPOSE.  See the
 * GNU General Public License for more details.
 */

/*---------------------------------------------------------------------------
 * This file is autogenerated file using gcdb parser. Please do not edit it.
 * Update input XML file to add a new entry or update variable in this file
 * VERSION = "1.0"
 *---------------------------------------------------------------------------*/
&mdss_mdp {
	dsi_hx8394d_lead_720p_video: qcom,mdss_dsi_hx8394d_lead_720p_video {
		qcom,mdss-dsi-panel-name = "hx8394d lead 720p video mode dsi panel";
		qcom,cont-splash-enabled;
		qcom,mdss-dsi-panel-controller = <&mdss_dsi0>;
		qcom,mdss-dsi-panel-type = "dsi_video_mode";
		qcom,mdss-dsi-panel-destination = "display_1";
		qcom,mdss-dsi-panel-framerate = <60>;
		qcom,mdss-dsi-panel-width = <720>;
		qcom,mdss-dsi-panel-height = <1280>;
		qcom,mdss-dsi-h-front-porch = <120>;
		qcom,mdss-dsi-h-back-porch = <120>;
		qcom,mdss-dsi-h-pulse-width = <8>;
		qcom,mdss-dsi-h-sync-skew = <0>;
		qcom,mdss-dsi-v-back-porch = <8>;
		qcom,mdss-dsi-v-front-porch = <10>;
		qcom,mdss-dsi-v-pulse-width = <4>;
		qcom,mdss-dsi-h-left-border = <0>;
		qcom,mdss-dsi-h-right-border = <0>;
		qcom,mdss-dsi-v-top-border = <0>;
		qcom,mdss-dsi-v-bottom-border = <0>;
		qcom,mdss-dsi-bpp = <24>;
		qcom,mdss-dsi-color-order = <0>;
		qcom,mdss-dsi-underflow-color = <0xff>;
		qcom,mdss-dsi-border-color = <0>;
		qcom,mdss-dsi-pixel-packing = <0>;
		qcom,mdss-dsi-on-command = [39 01 00 00 00 00 04 B9 FF 83 94 
39 01 00 00 00 00 09 BA 33 83 A0 6D B2 00 00 40 
39 01 00 00 00 00 10 B1 6C 12 12 23 04 11 F1 80 99 9F 23 80 C0 D2 58 
39 01 00 00 00 00 0C B2 00 64 0E 0D 12 23 08 08 1C 4D 00 
39 01 00 00 00 00 0D B4 00 FF 57 58 57 58 57 58 01 6C 01 6C // lijiangshuo modified for showing white rows 20140616 
39 01 00 00 00 00 02 BC 07 
39 01 00 00 00 00 04 BF 41 0E 01 
39 01 00 00 00 00 22 D3 00 00 00 00 00 14 10 32 10 00 00 00 32 13 C0 00 00 32 10 08 00 00 47 04 02 02 47 04 00 47 00 00 00 
39 01 00 00 00 00 2D D5 00 01 02 03 04 05 06 07 20 21 22 23 18 18 18 18 18 18 18 18 18 18 18 18 18 18 18 18 18 18 18 18 18 18 18 18 18 18 18 18 19 19 18 18 
39 01 00 00 00 00 2D D6 07 06 05 04 03 02 01 00 23 22 21 20 18 18 18 18 18 18 18 18 18 18 18 18 18 18 18 18 18 18 18 18 18 18 18 18 18 18 18 18 18 18 19 19 
39 01 00 00 00 00 2B E0 00 07 0C 33 3A 3F 11 34 06 0A 0C 17 0E 12 14 13 14 07 10 12 16 00 06 0B 33 3A 3F 11 34 07 0A 0C 17 0F 12 15 12 13 06 11 13 17 
39 01 00 00 00 00 02 CC 09 
39 01 00 00 00 00 02 D2 44 
39 01 00 00 00 00 03 C0 30 14 
39 01 00 00 00 00 05 C7 00 C0 40 C0 
39 01 00 00 00 00 03 B6 50 50 
39 01 00 00 00 00 0A C9 1F 2E 03 1E 81 1E 00 80 44 //Dimming Function 20140610
39 01 00 00 00 00 03 E4 02 01  // MIDDLE CE 20140605
39 01 00 00 00 00 02 B9 00 
39 01 00 00 00 00 02 51 00 
39 01 00 00 00 00 02 53 24 
39 01 00 00 00 00 02 55 03 
05 01 00 00 78 00 02 11 00 
05 01 00 00 14 00 02 29 00 ]; 
		qcom,mdss-dsi-off-command = [05 01 00 00 14 00 02 28 00 
05 01 00 00 0A 00 02 10 00 ];
		qcom,mdss-dsi-on-command-state = "dsi_lp_mode";
		qcom,mdss-dsi-off-command-state = "dsi_hs_mode";
		qcom,mdss-dsi-h-sync-pulse = <1>;
		qcom,mdss-dsi-traffic-mode = "burst_mode"; // <2>  
		qcom,mdss-dsi-lane-map = <0>;
		qcom,mdss-dsi-bllp-eof-power-mode;
		qcom,mdss-dsi-bllp-power-mode;
		qcom,mdss-dsi-lane-0-state;
		qcom,mdss-dsi-lane-1-state;
		qcom,mdss-dsi-lane-2-state;
		qcom,mdss-dsi-lane-3-state;
		qcom,mdss-dsi-panel-timings = [87 1C 12 00 42 42 18 20 17 03 04 00];
		qcom,mdss-dsi-t-clk-post = <0x04>;
		qcom,mdss-dsi-t-clk-pre = <0x1A>;
		qcom,mdss-dsi-bl-min-level = <1>;
		qcom,mdss-dsi-bl-max-level = <255>;
		qcom,mdss-dsi-dma-trigger = <4>;
		qcom,mdss-dsi-mdp-trigger = "none"; // <0>
		qcom,mdss-dsi-bl-pmic-control-type = "bl_ctrl_dcs";
		qcom,mdss-dsi-reset-sequence = <1 20>, <0 2>, <1 180>;
		qcom,mdss-dsi-lp11-init; // ljs add for lp11_init 20140616
	};
};
