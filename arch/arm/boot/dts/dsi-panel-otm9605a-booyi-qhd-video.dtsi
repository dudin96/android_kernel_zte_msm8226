/* Copyright (c) 2013, The Linux Foundation. All rights reserved.
 *
 * This program is free software; you can redistribute it and/or modify
 * it under the terms of the GNU General Public License version 2 and
 * only version 2 as published by the Free Software Foundation.
 *
 * This program is distributed in the hope that it will be useful,
 * but WITHOUT ANY WARRANTY; without even the implied warranty of
 * MERCHANTABILITY or FITNESS FOR A PARTICULAR PURPOSE.  See the
 * GNU General Public License for more details.
 */

/*---------------------------------------------------------------------------
 * This file is autogenerated file using gcdb parser. Please do not edit it.
 * Update input XML file to add a new entry or update variable in this file
 * VERSION = "1.0"
 *---------------------------------------------------------------------------*/
&mdss_mdp {
	dsi_otm9605a_booyi_qhd_vid: qcom,mdss_dsi_otm9605a_booyi_qhd_video {
		qcom,mdss-dsi-panel-name = "OTM9605 booyi qhd video mode dsi panel";
        qcom,cont-splash-enabled;
		qcom,mdss-dsi-panel-controller = <&mdss_dsi0>;
		qcom,mdss-dsi-panel-type = "dsi_video_mode";
		qcom,mdss-dsi-panel-destination = "display_1";
		qcom,mdss-dsi-panel-framerate = <60>;
		qcom,mdss-dsi-virtual-channel-id = <0>;
		qcom,mdss-dsi-stream = <0>;
		qcom,mdss-dsi-panel-width = <540>;
		qcom,mdss-dsi-panel-height = <960>;
		qcom,mdss-dsi-h-front-porch = <48>;
		qcom,mdss-dsi-h-back-porch = <96>;
		qcom,mdss-dsi-h-pulse-width = <96>;
		qcom,mdss-dsi-h-sync-skew = <0>;
		qcom,mdss-dsi-v-front-porch = <9>;
		qcom,mdss-dsi-v-pulse-width = <3>;
		qcom,mdss-dsi-v-back-porch = <13>;
		qcom,mdss-dsi-h-left-border = <0>;
		qcom,mdss-dsi-h-right-border = <0>;
		qcom,mdss-dsi-v-top-border = <0>;
		qcom,mdss-dsi-v-bottom-border = <0>;
		qcom,mdss-dsi-bpp = <24>;
		qcom,mdss-dsi-color-order = <0>;
		qcom,mdss-dsi-underflow-color = <0xff>;
		qcom,mdss-dsi-border-color = <0>;
		qcom,mdss-dsi-on-command = [
				15  01  00  00  00  00 02  00 00
                39  01  00  00  00  00 04  FF 96 05 01
                15  01  00  00  00  00 02  00 80
                39  01  00  00  00  00 03  FF 96 05
                15  01  00  00  00  00 02  00 92
                39  01  00  00  00  00 03  FF 10 02
                15  01  00  00  00  00 02  00 C5
                15  01  00  00  00  00 02  B0 03
                15  01  00  00  00  00 02  00 89
                15  01  00  00  00  00 02  C0 01
                15  01  00  00  00  00 02  00 83
                15  01  00  00  00  00 02  C5 40
                15  01  00  00  00  00 02  00 90
                39  01  00  00  00  00 03  C5 D6 B7
                15  01  00  00  00  00 02  00 B4
                15  01  00  00  00  00 02  C0 50
                15  01  00  00  00  00 02  00 80
                39  01  00  00  00  00 03  C1 36 66
                15  01  00  00  00  00 02  00 A0
                15  01  00  00  00  00 02  C1 00
                15  01  00  00  00  00 02  00 80
                15  01  00  00  00  00 02  C4 9C
                15  01  00  00  00  00 02  00 87
                15  01  00  00  00  00 02  C4 40
                15  01  00  00  00  00 02  00 93
                15  01  00  00  00  00 02  C5 76
                15  01  00  00  00  00 02  00 86
                15  01  00  00  00  00 02  C4 08
                15  01  00  00  00  00 02  00 84
                15  01  00  00  00  00 02  C4 08
                15  01  00  00  00  00 02  00 B1
                15  01  00  00  00  00 02  C5 28
                15  01  00  00  00  00 02  00 C0
                15  01  00  00  00  00 02  C5 00
                15  01  00  00  00  00 02  00 80
                15  01  00  00  00  00 02  C4 9C
                15  01  00  00  00  00 02  00 80
                39  01  00  00  00  00 0b  CB 00 00 00 00 00 00 00 00 00 00
                15  01  00  00  00  00 02  00 90
                39  01  00  00  00  00 10  CB 00 00 00 00 00 00 00 00 00 00 00 00 00 00 00
                15  01  00  00  00  00 02  00 A0
                39  01  00  00  00  00 10  CB 00 00 00 00 00 00 00 00 00 00 00 00 00 00 00
                15  01  00  00  00  00 02  00 B0
                39  01  00  00  00  00 0b  CB 00 00 00 00 00 00 00 00 00 00
                15  01  00  00  00  00 02  00 C0
                39  01  00  00  00  00 10  CB 00 00 00 04 04 04 04 04 04 04 04 00 00 00 00
                15  01  00  00  00  00 02  00 D0
                39  01  00  00  00  00 10  CB 00 00 00 00 00 00 00 00 04 04 04 04 04 04 04
                15  01  00  00  00  00 02  00 E0
                39  01  00  00  00  00 0b  CB 04 00 00 00 00 00 00 00 00 00
                15  01  00  00  00  00 02  00 F0
                39  01  00  00  00  00 0b  CB FF FF FF FF FF FF FF FF FF FF
                15  01  00  00  00  00 02  00 80
                39  01  00  00  00  00 0b  CC 00 00 00 03 01 09 0B 0D 0F 05
                15  01  00  00  00  00 02  00 90
                39  01  00  00  00  00 10  CC 07 00 00 00 00 00 00 00 00 00 00 00 00 04 02
                15  01  00  00  00  00 02  00 A0
                39  01  00  00  00  00 10  CC 0A 0C 0E 10 06 08 00 00 00 00 00 00 00 00 00
                15  01  00  00  00  00 02  00 80
                39  01  00  00  00  00 0d  CE 87 03 06 86 03 06 85 03 06 84 03 06
                15  01  00  00  00  00 02  00 90
                39  01  00  00  00  00 0e  CE 33 Be 06 33 Bf 06 33 c0 06 33 C1 06 00
                15  01  00  00  00  00 02  00 A0
                39  01  00  00  00  00 0f  CE 38 05 03 C6 00 06 00 38 04 03 C7 00 06 00
                15  01  00  00  00  00 02  00 B0
                39  01  00  00  00  00 0f  CE 38 03 03 C8 00 06 00 38 02 03 C9 00 06 00
                15  01  00  00  00  00 02  00 C0
                39  01  00  00  00  00 0f  CE 38 01 03 Ca 00 06 00 38 00 03 Cb 00 06 00
                15  01  00  00  00  00 02  00 D0
                39  01  00  00  00  00 0f  CE 30 00 03 Cc 00 06 00 30 01 03 Cd 00 06 00
                15  01  00  00  00  00 02  00 80
                39  01  00  00  00  00 0f  CF F0 00 00 10 00 00 00 F0 00 00 10 00 00 00
                15  01  00  00  00  00 02  00 90
                39  01  00  00  00  00 0f  CF F0 00 00 10 00 00 00 F0 00 00 10 00 00 00
                15  01  00  00  00  00 02  00 A0
                39  01  00  00  00  00 0f  CF F0 00 00 10 00 00 00 F0 00 00 10 00 00 00
                15  01  00  00  00  00 02  00 B0
                39  01  00  00  00  00 0f  CF F0 00 00 10 00 00 00 F0 00 00 10 00 00 00
                15  01  00  00  00  00 02  00 C0
                39  01  00  00  00  00 0b  CF 01 01 20 20 00 00 02 01 00 00
                15  01  00  00  00  00 02  00 00
                39  01  00  00  00  00 03  D8 87 87
                15  01  00  00  00  00 02  00 00
                15  01  00  00  00  00 02  D9 1F
                15  01  00  00  00  00 02  00 00
                39  01  00  00  00  00 11  E1 01 04 07 0B 04 08 08 06 07 0A 12 08 0F 16 0D 08
                15  01  00  00  00  00 02  00 00
                39  01  00  00  00  00 11  E2 01 05 08 0B 04 09 09 07 07 0A 12 08 0F 16 0D 08
                15  01  00  00  00  00 02  00 80
                39  01  00  00  00  00 03  FF FF FF
                15  01  00  00  00  00 02  00 00
                39  01  00  00  00  00 04  FF FF FF FF 
                15  01  00  00  00  00 02  51 ff
                15  01  00  00  00  00 02  53 2c
                15  01  00  00  00  00 02  55 03
                05  01  00  00  96  00 02  11 00                
                05  01  00  00  78  00 02  29 00
		];
		qcom,mdss-dsi-off-command = [05 01 00 00 32 00 02 28 00
					05 01 00 00 78 00 02 10 00];
		qcom,mdss-dsi-on-command-state = "dsi_lp_mode";
		qcom,mdss-dsi-off-command-state = "dsi_lp_mode";
		qcom,mdss-dsi-h-sync-pulse = <1>;
		qcom,mdss-dsi-traffic-mode = <2>;
		qcom,mdss-dsi-lane-map = <1>;
		qcom,mdss-dsi-bllp-eof-power-mode;
		qcom,mdss-dsi-bllp-power-mode;
		qcom,mdss-dsi-lane-0-state;
		qcom,mdss-dsi-lane-1-state;
		qcom,mdss-dsi-panel-timings = [97 23 17 00 4B 53 1C 27 27 03 04 00];
		qcom,mdss-dsi-t-clk-post = <0x04>;
		qcom,mdss-dsi-t-clk-pre = <0x1b>;
		qcom,mdss-dsi-bl-min-level = <1>;
		qcom,mdss-dsi-bl-max-level = <255>;
		qcom,mdss-dsi-dma-trigger = <4>;
		qcom,mdss-dsi-mdp-trigger = <0>;
		qcom,mdss-dsi-bl-pmic-control-type = "bl_ctrl_wled";
		qcom,mdss-dsi-reset-sequence = <1 20>, <0 2>, <1 20>;

	};
};
