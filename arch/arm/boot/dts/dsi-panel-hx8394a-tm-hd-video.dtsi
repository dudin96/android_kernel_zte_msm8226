/* Copyright (c) 2013, The Linux Foundation. All rights reserved.
 *
 * This program is free software; you can redistribute it and/or modify
 * it under the terms of the GNU General Public License version 2 and
 * only version 2 as published by the Free Software Foundation.
 *
 * This program is distributed in the hope that it will be useful,
 * but WITHOUT ANY WARRANTY; without even the implied warranty of
 * MERCHANTABILITY or FITNESS FOR A PARTICULAR PURPOSE.  See the
 * GNU General Public License for more details.
 */

/*---------------------------------------------------------------------------
 * This file is autogenerated file using gcdb parser. Please do not edit it.
 * Update input XML file to add a new entry or update variable in this file
 * VERSION = "1.0"
 *---------------------------------------------------------------------------*/
&mdss_mdp {
	dsi_hx8394a_tm_hd_video: qcom,mdss_dsi_hx8394a_tm_hd_command {
		qcom,mdss-dsi-panel-name = "hx8394a tm hd video mode dsi panel";
        qcom,cont-splash-enabled;
		qcom,mdss-dsi-panel-controller = <&mdss_dsi0>;
		qcom,mdss-dsi-panel-type = "dsi_video_mode";
		qcom,mdss-dsi-panel-destination = "display_1";
		qcom,mdss-dsi-panel-framerate = <60>;
		qcom,mdss-dsi-virtual-channel-id = <0>;
		qcom,mdss-dsi-stream = <0>;
		qcom,mdss-dsi-panel-width = <720>;
		qcom,mdss-dsi-panel-height = <1280>;
		qcom,mdss-dsi-h-front-porch = <96>;
		qcom,mdss-dsi-h-back-porch = <48>;
		qcom,mdss-dsi-h-pulse-width = <18>;
		qcom,mdss-dsi-h-sync-skew = <0>;
		qcom,mdss-dsi-v-back-porch = <17>;
		qcom,mdss-dsi-v-front-porch = <8>;
		qcom,mdss-dsi-v-pulse-width = <5>;
		qcom,mdss-dsi-h-left-border = <0>;
		qcom,mdss-dsi-h-right-border = <0>;
		qcom,mdss-dsi-v-top-border = <0>;
		qcom,mdss-dsi-v-bottom-border = <0>;
		qcom,mdss-dsi-bpp = <24>;
		qcom,mdss-dsi-color-order = <0>;
		qcom,mdss-dsi-underflow-color = <0xff>;
		qcom,mdss-dsi-border-color = <0>;
		qcom,mdss-dsi-pixel-packing = <0>;
		qcom,mdss-dsi-pixel-alignment = <0>;
		qcom,mdss-dsi-on-command = [39 01 00 00 00 00 04
						B9 FF 83 94         
				           39 01 00 00 00 00 11     
						BA 13 82 00   
						16 C5 10 10   
						FF 0F 24 03   
						21 24 25 20   
						08    	 	
				           39 01 00 00 00 00 11
						B1 01 00 37                                           
						87 01 11 11  	                                 
						21 29 2B 2B   	                                       
						57 02 00 E6 
						E2     
				           39 01 00 00 00 00 0D     
						B2 00 C8 14 
						06 00 88 00 
						FF 00 00 05 
						11    
				           39 01 00 00 00 00 17     
						B4 80 08 32 
						10 0C 32 10 
						07 22 10 08 
						37 04 4A 0B 
						37 04 4A 06 
						5A 5A 06 
				           39 01 00 00 00 00 05         
						BF 06 00 10 
						04 
				           39 01 00 00 00 00 35        
						D5 00 00 00 
						10 0A 00 01 
						33 00 00 33 
						00 23 01 67 
						45 23 01 88 
						88 88 88 88 
						88 88 99 99 
						99 45 67 99 
						88 54 76 10 
						32 32 10 88 
						88 88 88 88 
						88 88 88 48 
						85 76 54 88 
						99      
				           39 01 00 00 00 00 02      
						B6 0E       
				           39 01 00 00 00 00 02      
						CC 09   
				           39 01 00 00 00 00 02      
						D4 32       
				           39 01 00 00 00 00 03     
						C0 0C 17        
				           39 01 00 00 00 00 03      
						C6 00 08       
				           39 01 00 00 00 00 05     
						C7 00 10 00 
						10      
				           39 01 00 00 00 00 2B
						E0 00 0A 0D 
						30 38 3F 14 
						36 06 0C 0C 
						0E 0F 0E 10 
						11 13 00 0A 
						0D 30 38 3F 
						14 36 06 0C 
						0C 0E 0F 0E 
						10 11 13 09 
						16 06 14 09 
						16 06 14 
            				05 01 00 00 96 00 02 11 00
 					05 01 00 00 78 00 02 29 00];
		qcom,mdss-dsi-off-command = [05 01 00 00 32 00 02 28 00
					05 01 00 00 78 00 02 10 00];
		qcom,mdss-dsi-on-command-state = "dsi_lp_mode";
		qcom,mdss-dsi-off-command-state = "dsi_hs_mode";
		qcom,mdss-dsi-h-sync-pulse = <1>;
		qcom,mdss-dsi-traffic-mode = <2>;
		qcom,mdss-dsi-lane-map = <0>;
		qcom,mdss-dsi-bllp-eof-power-mode;
		qcom,mdss-dsi-bllp-power-mode;
		qcom,mdss-dsi-lane-0-state;
		qcom,mdss-dsi-lane-1-state;
		qcom,mdss-dsi-lane-2-state;
		qcom,mdss-dsi-lane-3-state;
		qcom,mdss-dsi-te-pin-select = <1>;
		qcom,mdss-dsi-te-v-sync-rd-ptr-irq-line = <0x2c>;
		qcom,mdss-dsi-te-dcs-command = <1>;
		qcom,mdss-dsi-te-check-enable;
		qcom,mdss-dsi-te-using-te-pin;
		qcom,mdss-dsi-panel-timings = [2E 18 10 00 3C 3E 14 1C 12 03 04 00];
		qcom,mdss-dsi-t-clk-post = <0x04>;
		qcom,mdss-dsi-t-clk-pre = <0x11>;
		qcom,mdss-dsi-bl-min-level = <1>;
		qcom,mdss-dsi-bl-max-level = <255>;
		qcom,mdss-dsi-dma-trigger = <4>;
		qcom,mdss-dsi-mdp-trigger = <0>;
		qcom,mdss-dsi-bl-pmic-control-type = "bl_ctrl_dcs";
		qcom,mdss-dsi-reset-sequence = <1 20>, <0 2>, <1 20>;
        qcom,mdss-panel-id= "nt35590-tm-hd-command";
	};
};
