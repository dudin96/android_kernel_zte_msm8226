/* Copyright (c) 2013, The Linux Foundation. All rights reserved.
 *
 * This program is free software; you can redistribute it and/or modify
 * it under the terms of the GNU General Public License version 2 and
 * only version 2 as published by the Free Software Foundation.
 *
 * This program is distributed in the hope that it will be useful,
 * but WITHOUT ANY WARRANTY; without even the implied warranty of
 * MERCHANTABILITY or FITNESS FOR A PARTICULAR PURPOSE.  See the
 * GNU General Public License for more details.
 */

/include/ "dsi-panel-hx8394a-720p-video.dtsi"
/include/ "dsi-panel-nt35590-720p-video.dtsi"
/include/ "dsi-panel-nt35521-720p-video.dtsi"
/include/ "dsi-panel-nt35596-1080p-video.dtsi"
/include/ "dsi-panel-nt35590-720p-cmd.dtsi"
/include/ "dsi-panel-ssd2080m-720p-video.dtsi"
/include/ "dsi-panel-jdi-1080p-video.dtsi"
/include/ "dsi-panel-otm8018b-lead-fwvga-video.dtsi"
/include/ "dsi-panel-ili9806e-yassy-fwvga-video.dtsi"
/include/ "dsi-panel-otm9605a-booyi-qhd-video.dtsi"
/include/ "dsi-panel-hx8379-yushun-fwvga-video.dtsi"
/include/ "dsi-panel-nt35590-tm-hd-command.dtsi"
/include/ "dsi-panel-nt35590-success-hd-command.dtsi"
/include/ "dsi-panel-hx8394a-tm-hd-video.dtsi"
/include/ "dsi-panel-HX8379A-TM-TM-4p5-FWVGA-video-zte-402.dtsi"
/include/ "dsi-panel-HX8379A-LEAD-TN-4p5-FWVGA-video-zte-401.dtsi"
/include/ "dsi-panel-nt35521-yushun-720p-video.dtsi" // lijiangshuo add for P826N33 LCD 20140430
/include/ "dsi-panel-hx8394d-lead-720p-video.dtsi" // lijiangshuo add for P826N33 LCD 20140430
