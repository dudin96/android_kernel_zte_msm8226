/* Copyright (c) 2013, The Linux Foundation. All rights reserved.
 *
 * This program is free software; you can redistribute it and/or modify
 * it under the terms of the GNU General Public License version 2 and
 * only version 2 as published by the Free Software Foundation.
 *
 * This program is distributed in the hope that it will be useful,
 * but WITHOUT ANY WARRANTY; without even the implied warranty of
 * MERCHANTABILITY or FITNESS FOR A PARTICULAR PURPOSE.  See the
 * GNU General Public License for more details.
 */

/*---------------------------------------------------------------------------
 * This file is autogenerated file using gcdb parser. Please do not edit it.
 * Update input XML file to add a new entry or update variable in this file
 * VERSION = "1.0"
 *---------------------------------------------------------------------------*/
&mdss_mdp {
	dsi_hx8379_yushun_fwvga_vid: qcom,mdss_dsi_hx8379_yushun_fwvga_video {        
		qcom,mdss-dsi-panel-name = "hx8379 yushun fwvga video mode dsi panel";
        qcom,cont-splash-enabled;
		qcom,mdss-dsi-panel-controller = <&mdss_dsi0>;
		qcom,mdss-dsi-panel-type = "dsi_video_mode";
		qcom,mdss-dsi-panel-destination = "display_1";
		qcom,mdss-dsi-panel-framerate = <60>;
		qcom,mdss-dsi-virtual-channel-id = <0>;
		qcom,mdss-dsi-stream = <0>;
		qcom,mdss-dsi-panel-width = <480>;
		qcom,mdss-dsi-panel-height = <854>;
        qcom,mdss-dsi-h-front-porch = <100>;
		qcom,mdss-dsi-h-back-porch = <74>;
		qcom,mdss-dsi-h-pulse-width = <30>;
		qcom,mdss-dsi-h-sync-skew = <0>;
		qcom,mdss-dsi-v-back-porch = <5>; /*7*/
		qcom,mdss-dsi-v-front-porch = <12>;
		qcom,mdss-dsi-v-pulse-width = <4>; /*2*/
		qcom,mdss-dsi-h-left-border = <0>;
		qcom,mdss-dsi-h-right-border = <0>;
		qcom,mdss-dsi-v-top-border = <0>;
		qcom,mdss-dsi-v-bottom-border = <0>;
		qcom,mdss-dsi-bpp = <24>;
		qcom,mdss-dsi-color-order = <0>;
		qcom,mdss-dsi-underflow-color = <0xff>;
		qcom,mdss-dsi-border-color = <0>;
		qcom,mdss-dsi-on-command = [
			39 01 00 00 00 00 04 B9 FF 83 79
            39 01 00 00 00 00 03 BA 51 93
            39 01 00 00 00 00 14 B1 00 50 14 ED 
                90 08 11 10 F0 26 2C 9A 1A 43
                01 12 F0 20 E6
            39 01 00 00 00 00 0e B2 00 00 FE 07 0a 19 A4 00 FF 07 0a
                19 20
            /*39 01 00 00 00 00 20 B4 82 08 00 32
                10 04 32 13 70 32 10 08 37 01
                28 06 37 04 3e 08 42 42 04 00
                40 08 28 08 30 30 04*/
             39 01 00 00 00 00 20 B4 80 08 00 32
                10 04 32 13 70 32 10 08 37 01
                28 06 37 00 31 01 33 33 01 00
                40 08 28 08 30 30 04
                
            39 01 00 00 00 00 02 CC 02
            
            39 01 00 00 00 00 30 D5 00 00 0A 00 01
                00 00 03 00 88 88 88 88 23 01 
                67 45 02 13 88 88 88 88 88 88 
                88 88 88 88 54 76 10 32 31 20 
                88 88 88 88 88 88 00 00 00 00 
                00 00
            39 01 00 00 00 00 24 E0 79 00 00 06 20 
                21 3f 29 42 08 0F 11 14 17 15 
                15 10 14 00 00 06 20 21 3f 29 
                42 08 0F 11 14 17 15 15 10 14            
            39 01 00 00 00 00 05 B6 00 89 00 89
            39 01 00 00 00 00 03 C9 0F 04
            39 01 00 00 00 00 03 C6 00 04
            05 01 00 00 96 00 02 11 00                
            05 01 00 00 78 00 02 29 00            
					];
		qcom,mdss-dsi-off-command = [05 01 00 00 32 00 02 28 00
					05 01 00 00 78 00 02 10 00];
		qcom,mdss-dsi-on-command-state = "dsi_lp_mode";
		qcom,mdss-dsi-off-command-state = "dsi_hs_mode";
		qcom,mdss-dsi-h-sync-pulse = <0>;
		qcom,mdss-dsi-traffic-mode = <2>;
		qcom,mdss-dsi-lane-map = <1>;
		qcom,mdss-dsi-bllp-eof-power-mode;
		qcom,mdss-dsi-bllp-power-mode;
		qcom,mdss-dsi-lane-0-state;
		qcom,mdss-dsi-lane-1-state;
		/*qcom,mdss-dsi-panel-timings = [8B 1F 14 00 45 4A 19 23 23 03 04 00];*/
    /*   qcom,mdss-dsi-panel-timings = [36 18 10 00 3A 3E 14 1C 12 03 04 00];*/
    qcom,mdss-dsi-panel-timings = [7A 1A 12 00 3E 42 16 1E 14 03 04 00];
		qcom,mdss-dsi-t-clk-post = <0x04>;
		qcom,mdss-dsi-t-clk-pre = <0x1A>; /*0x1b*/
		qcom,mdss-dsi-bl-min-level = <1>;
		qcom,mdss-dsi-bl-max-level = <255>;
		qcom,mdss-dsi-dma-trigger = <4>;
		qcom,mdss-dsi-mdp-trigger = <0>;
		qcom,mdss-dsi-bl-pmic-control-type = "bl_ctrl_dcs";
		qcom,mdss-dsi-reset-sequence = <1 20>, <0 2>, <1 20>;
        qcom,mdss-panel-id= "hx8379_yushun_fwvga_video";
	};
};
